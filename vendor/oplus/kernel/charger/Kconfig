## vendor/oplus/kernel/charger/Kconfig
```kconfig
# SPDX-License-Identifier: GPL-2.0-only

config OPLUS_CHG
	tristate "OPLUS CHARGER KO module"
	default m
	help
	  Enables support for the oplus charging framework

config OPLUS_CHARGER_MTK
	bool "OPLUS charger on MTK"
	help
	  Say Y here to declare charging system is on MTK

config OPLUS_SHORT_C_BATT_CHECK
	bool "OPLUS_SHORT_C_BATT CHECK SUPPORT"
	default n
	help
	  Say Y to include support

config OPLUS_CALL_MODE_SUPPORT
	bool "OPLUS call mode support"
	help
	  Say Y to include support

config OPLUS_SMART_CHARGER_SUPPORT
	bool "OPLUS smart charger support"
	help
	  Say Y to include support

config OPLUS_SHORT_HW_CHECK
	bool "OPLUS_SHORT_HW CHECK SUPPORT"
	default n
	help
	  Say Y to include support

config OPLUS_CHIP_SOC_NODE
	bool "OPLUS chip soc node"
	help
	  Say Y to include support

config OPLUS_SHORT_IC_CHECK
	bool "OPLUS_SHORT_IC CHECK SUPPORT"
	default n
	help
	  Say Y to include support

config OPLUS_SHORT_USERSPACE
	bool "OPLUS batt userspace"
	help
	 Say Y to include support

config OPLUS_RTC_DET_SUPPORT
	bool "OPLUS RTC DET SUPPORT"
	default n
	help
	  Say Y to include support

config OPLUS_CHECK_CHARGERID_VOLT
	bool "OPLUS CHECK CHARGERID VOLT"
	default n
	help
	  Say Y to include support

config OPLUS_SHIP_MODE_SUPPORT
	bool "OPLUS_SHIP_MODE_SUPPORT"
	default n
	help
	  Say Y to include support

config OPLUS_CHG_DYNAMIC_CONFIG
	bool "OPLUS_CHG_DYNAMIC_CONFIG"
	default n
	help
	  Say Y to include support

source "drivers/power/oplus/v1/Kconfig"

menuconfig OPLUS_CHG_V2
	tristate "OPLUS charging V2 system"
	default m
	depends on I2C
	select REGMAP_I2C
	help
	  Say Y here to enable OPLUS charging V2 system support

if OPLUS_CHG_V2
source "drivers/power/oplus/v2/Kconfig"
endif

#endif
```
