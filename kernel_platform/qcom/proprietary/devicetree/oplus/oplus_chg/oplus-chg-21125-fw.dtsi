&rk826_fastcg {
	oplus,firmware_data = [
		00 00 34 55 48 38 00 00 64 00 00 00 64 00 00 00 01 c8 ec b8 fd 79 1e 8e 00 00 00 00 00 00 00 00
		00 00 00 00 00 00 00 00 00 00 00 00 00 00 00 00 00 00 00 00 00 00 00 00 00 00 00 00 00 00 00 00
		00 00 00 00 00 00 00 00 00 00 00 00 00 00 00 00 00 00 00 00 00 00 00 00 00 00 00 00 00 00 00 00
		00 00 00 00 00 00 00 00 00 00 00 00 00 00 00 00 00 00 00 00 00 00 00 00 00 00 00 00 00 00 00 00
		00 08 00 20 0d 01 00 21 a9 09 00 21 79 09 00 21 00 00 00 00 00 00 00 00 00 00 00 00 00 00 00 00
		00 00 00 00 00 00 00 00 00 00 00 00 2b 0a 00 21 00 00 00 00 00 00 00 00 29 0a 00 21 2d 0a 00 21
		2f 01 00 21 11 09 00 21 2f 01 00 21 31 0a 00 21 2f 01 00 21 2f 01 00 21 2f 01 00 21 2f 01 00 21
		49 0b 00 21 2f 01 00 21 2f 01 00 21 2f 01 00 21 03 48 85 46 00 f0 dc fb 00 48 00 47 b5 20 00 21
		00 08 00 20 40 1e fd d8 70 47 00 00 08 48 09 49 01 60 08 20 c0 00 01 20 80 f3 10 88 00 bf 00 bf
		05 48 00 47 fe e7 fe e7 fe e7 fe e7 fe e7 fe e7 00 00 02 50 00 80 00 80 f1 00 00 21 30 b5 0b 46
		01 46 00 20 20 22 01 24 09 e0 0d 46 d5 40 9d 42 05 d3 1d 46 95 40 49 1b 25 46 95 40 40 19 15 46
		52 1e 00 2d f1 dc 30 bd 70 b5 00 24 25 46 00 28 01 da 01 24 40 42 00 29 01 da 01 25 49 42 ff f7
		dd ff ac 42 00 d0 40 42 00 2c 00 d0 49 42 70 bd f8 b5 02 46 4a 40 d4 0f 42 00 4b 00 52 08 5b 08
		9a 42 02 d2 02 46 08 46 11 46 4a 00 23 d0 c3 0d 4a 00 dd b2 12 0e ad 1a 20 2d 35 da 49 02 01 26
		49 0a f6 05 8a 19 00 2c 00 d0 52 42 20 21 4f 1b 11 46 b9 40 2a 41 10 18 c2 0d 9a 42 21 d0 00 2c
		17 d0 01 2d 08 dc da 05 80 1a d2 0f 80 19 d2 07 db b2 00 f0 c4 fa f8 bd da 05 80 1a 01 23 40 00
		1b 06 c0 18 80 18 5a 42 80 18 ca 0f 10 43 49 00 07 e0 49 08 c2 07 11 43 da 05 80 1a 80 19 40 08
		80 18 00 f0 a4 fa f8 bd 61 00 01 22 51 1a 00 1b f7 e7 01 22 d2 07 51 40 aa e7 01 22 d2 07 50 40
		a6 e7 02 46 70 b5 4a 40 d3 0f db 07 40 00 2d d0 4a 00 2a d0 01 0e 14 0e 00 02 12 02 09 19 40 0a
		52 0a 84 18 e5 01 04 46 54 43 00 0a 12 0a 2e 04 50 43 a4 19 42 19 20 0c c5 43 aa 18 12 0c 01 25
		ad 03 52 1c 52 19 12 04 7f 39 24 04 00 d0 52 1c 10 43 01 d4 40 00 49 1e c2 b2 0c 06 c0 09 20 18
		40 1c 40 08 80 2a 02 d0 03 e0 00 20 70 bd 40 08 40 00 00 29 00 da 00 20 18 43 70 bd 70 b5 02 46
		4a 40 d5 0f 40 00 4a 00 ed 07 40 08 52 08 00 28 14 d0 00 2a 12 d0 c4 0d d3 0d 41 02 01 20 c0 05
		52 02 49 0a 52 0a e4 1a 09 18 12 18 7d 34 91 42 01 d3 64 1c 00 e0 49 00 00 2c 01 da 00 20 70 bd
		00 23 91 42 01 d3 89 1a 03 43 40 08 49 00 00 28 f7 d1 00 29 0a d0 91 42 02 d1 01 21 c9 07 05 e0
		91 42 01 d2 01 21 01 e0 01 21 c9 43 e0 05 c0 18 40 19 00 f0 1c fa 70 bd f0 b5 07 46 08 46 58 40
		87 b0 c0 0f 04 90 48 00 0e 46 59 00 40 08 49 08 bc 1a 88 41 05 d2 38 46 31 46 1e 46 17 46 0b 46
		02 46 58 00 40 08 10 43 4c d0 30 0d 03 90 40 05 59 00 40 0d 49 0d 05 90 40 1a 02 90 40 28 72 da
		18 03 01 21 00 0b 09 05 08 43 01 90 04 98 00 92 00 28 05 d0 01 99 52 42 00 20 88 41 00 92 01 90
		02 98 40 21 0a 1a 01 99 00 98 00 f0 bd f9 05 46 0c 46 6b 46 07 cb 00 f0 c7 f9 c0 19 71 41 03 9a
		0e 0d 00 23 d7 17 56 40 1a 46 7a 40 16 43 44 d0 04 9a 00 2a 2d d0 02 9a 01 2a 03 9a 15 dc 12 05
		c0 1a 91 41 01 26 36 05 00 1c 71 41 d2 0f 05 9e d2 07 00 93 01 92 02 96 2a 46 23 46 00 f0 05 fa
		07 b0 f0 bd 38 46 31 46 fa e7 16 05 22 4a 0f 46 b2 18 c0 1a b7 41 01 21 09 05 00 1c 4f 41 00 18
		7f 41 11 46 18 18 79 41 e2 0f 10 43 6d 19 64 41 13 e0 e2 07 6d 08 15 43 64 08 c2 07 14 43 03 9a
		01 26 12 05 c0 1a 91 41 36 05 00 1c 71 41 ce 07 40 08 30 43 49 08 c0 18 51 41 2a 46 23 46 00 f0
		c7 f9 cd e7 ff e7 04 98 01 22 40 00 c1 17 12 1a 00 23 8b 41 04 98 31 46 c4 17 38 1a a1 41 ee e7
		30 b4 01 24 e4 07 63 40 30 bc 55 e7 30 b4 01 24 e4 07 61 40 30 bc 4f e7 00 00 e0 ff f0 b5 1f b4
		88 b0 0b 99 09 98 00 24 48 40 09 99 c0 0f 49 00 49 08 09 91 c0 07 0b 99 00 90 49 00 49 08 0b 91
		09 99 08 98 a6 46 08 43 1c d0 0b 99 0a 98 08 43 18 d0 09 98 01 24 40 00 42 0d 48 00 41 0d 09 98
		24 05 00 03 00 0b 20 43 09 90 0b 98 00 03 00 0b 20 43 0b 90 50 18 1c 49 40 18 00 22 01 90 14 46
		10 46 05 e0 00 20 01 46 0d b0 f0 bd 03 28 01 da 03 46 00 e0 03 23 9c 46 c1 1a 0a ae 0a e0 5f 00
		08 ad ed 5b 4f 00 f7 5b 7d 43 00 27 aa 18 7c 41 49 1c 5b 1e 61 45 f2 dd 41 00 04 ab 5a 52 21 04
		12 0c 0a 43 24 0c 40 1c 08 28 df db 01 98 02 90 00 99 70 46 01 91 00 90 05 9b 04 9a 07 99 06 98
		00 f0 53 f9 d0 e7 00 00 0d fc ff ff f0 b5 0c 46 5c 40 85 b0 e4 0f e4 07 03 94 4c 00 00 26 64 08
		59 00 94 46 49 08 02 46 02 96 22 43 21 d0 62 46 0a 43 1e d0 62 00 57 0d 4a 00 0e 03 23 03 55 0d
		01 24 02 46 2c 49 24 05 78 1b 1b 0b 36 0b 40 18 23 43 26 43 61 46 00 90 1c 46 50 1a b4 41 03 d3
		00 98 40 1c 00 90 02 e0 92 18 00 98 5b 41 00 28 03 da 00 20 01 46 05 b0 f0 bd 00 20 01 21 09 05
		07 46 86 46 11 e0 64 46 1d 46 14 1b b5 41 06 d3 65 46 52 1b b3 41 74 46 07 43 0c 43 a6 46 cd 07
		40 08 49 08 28 43 92 18 5b 41 05 46 0d 43 ea d1 10 46 18 43 13 d0 60 46 19 46 50 40 71 40 08 43
		06 d0 60 46 10 1a b3 41 06 d2 01 22 00 23 06 e0 00 22 01 23 db 07 02 e0 01 22 d2 43 53 10 00 98
		74 46 01 05 38 1c 61 41 02 9c 03 9d 00 19 69 41 00 f0 ce f8 bf e7 00 00 fd 03 00 00 c2 17 c1 0f
		50 40 10 b5 40 18 ca 07 96 23 00 21 00 f0 87 f8 10 bd 10 b5 00 22 96 23 11 46 00 f0 80 f8 10 bd
		c2 0f 41 00 40 02 01 23 40 0a db 05 d2 07 09 0e c0 18 7f 29 01 da 00 20 70 47 96 29 03 dc 96 23
		59 1a c8 40 01 e0 96 39 88 40 00 2a f4 d0 40 42 70 47 c2 0f d2 07 40 00 40 08 0b d0 c1 0d 07 23
		db 01 c9 18 40 02 09 05 40 0a 11 43 c2 08 40 07 11 43 70 47 00 20 01 46 70 47 cb 0f db 07 49 00
		10 b5 49 08 02 46 0a 43 07 d0 0a 0d 07 24 09 03 e4 01 09 0b 12 1b 00 2a 01 dc 00 20 10 bd c9 00
		44 0f 0c 43 c1 00 e0 18 d2 05 80 18 00 f0 2f f8 10 bd 00 00 01 22 d2 07 00 28 00 db 10 1a 00 29
		00 db 51 1a 81 42 70 47 10 b5 20 2a 04 db 01 46 20 3a 91 40 00 20 10 bd 91 40 20 23 9c 1a 03 46
		e3 40 19 43 90 40 10 bd 10 b5 20 2a 06 db cb 17 08 46 20 3a 10 41 c1 17 0b 43 06 e0 0b 46 13 41
		d0 40 20 24 a2 1a 91 40 08 43 19 46 10 bd 00 29 04 da 40 1c 49 00 01 d1 40 08 40 00 70 47 70 b4
		00 24 05 0c 05 d1 10 24 00 04 02 d1 00 29 21 d0 11 24 05 0e 01 d1 00 02 08 34 05 0f 01 d1 00 01
		24 1d 85 0f 01 d1 80 00 a4 1c 00 28 01 db 40 00 64 1c 00 29 08 d0 20 25 2e 1b 0d 46 f5 40 a1 40
		00 d0 01 21 29 43 08 43 01 06 1b 1b 00 0a db 1d 02 d5 00 20 70 bc 70 47 db 05 18 18 80 18 00 29
		f8 da 40 1c 49 00 f5 d1 70 bc 40 08 40 00 70 47 10 b5 00 2b 08 da 00 24 40 1c 61 41 92 18 5b 41
		1a 43 01 d1 40 08 40 00 10 bd f0 b5 1f b4 82 b0 05 46 0c 00 03 d0 08 46 00 f0 a2 f9 02 e0 00 f0
		9f f9 20 30 02 46 00 90 21 46 28 46 ff f7 7c ff 04 9b 05 9a 04 46 0f 46 18 43 11 43 08 43 14 d0
		18 46 10 43 1b d0 00 98 40 21 0a 1a 18 46 05 99 00 f0 40 f8 05 46 0e 46 00 9a 05 99 04 98 ff f7
		63 ff 08 43 05 d0 01 20 04 e0 20 46 39 46 07 b0 f0 bd 00 20 c1 17 05 43 0e 43 2c 43 37 43 00 99
		0e 98 63 05 40 1a 79 05 e4 0a 00 22 0c 43 fd 0a 0a 30 02 d5 00 20 01 46 e9 e7 01 05 10 19 69 41
		0c 9c 0d 9d 00 19 69 41 ff f7 a2 ff df e7 00 00 06 4c 01 25 06 4e 05 e0 e3 68 07 cc 2b 43 0c 3c
		98 47 10 34 b4 42 f7 d3 ff f7 16 fc 34 38 00 21 44 38 00 21 10 b5 20 2a 04 db 08 46 20 3a d0 40
		00 21 10 bd 0b 46 d3 40 d0 40 20 24 a2 1a 91 40 08 43 19 46 10 bd 10 b5 04 46 20 01 00 09 ff f7
		01 fc 10 bd 00 bf 01 46 40 1e 00 29 fb d1 70 47 10 b5 02 f0 67 f9 04 46 80 20 20 40 00 28 18 d0
		80 20 02 f0 59 f9 10 48 00 78 00 28 07 d1 02 f0 a3 fc 00 20 0d 49 08 70 01 20 0b 49 08 70 0c 48
		00 78 02 28 02 d1 00 f0 3f f9 0c e0 00 f0 04 fd 09 e0 40 20 20 40 00 28 05 d0 40 20 02 f0 3c f9
		01 20 04 49 08 70 10 bd 71 01 00 20 38 01 00 20 5f 01 00 20 11 01 00 20 00 bf fe e7 70 b5 04 46
		0d 46 16 46 2b 46 32 46 21 46 55 20 02 f0 ec f9 70 bd 70 b5 04 46 0d 46 16 46 2b 46 32 46 21 46
		55 20 02 f0 7f fa 70 bd 70 47 00 00 70 b5 00 21 00 23 0f 22 c4 78 00 2c 25 d0 19 4c e4 68 07 25
		2d 02 2c 40 2c 1b 21 0a 04 24 63 1a 14 46 cc 40 22 46 44 78 9c 40 21 46 84 78 14 40 21 43 09 01
		10 4c 03 25 2d 02 64 19 05 78 ad 00 61 51 04 78 e5 06 ed 0e 01 24 ac 40 05 78 6d 11 ad 00 09 4e
		ad 19 2c 60 0a e0 04 78 e5 06 ed 0e 01 24 ac 40 04 4d 80 35 06 78 76 11 b6 00 ac 51 70 bd 00 00
		00 ed 00 e0 00 e1 00 e0 70 47 70 47 70 47 00 00 10 b5 00 20 02 f0 da fa 37 48 00 88 00 28 05 d0
		35 48 00 88 40 1e 34 49 08 80 15 e0 7d 20 c0 00 31 49 08 80 31 48 00 88 00 28 04 d0 2f 48 00 88
		40 1e 2e 49 08 80 2e 48 00 88 00 28 04 d0 2c 48 00 88 40 1e 2a 49 08 80 2a 48 00 68 00 28 04 d0
		28 48 00 68 40 1e 27 49 08 60 27 48 00 68 00 28 04 d0 25 48 00 68 40 1e 23 49 08 60 23 48 00 68
		00 28 04 d0 21 48 00 68 40 1e 20 49 08 60 20 48 00 78 00 28 04 d0 1e 48 00 78 40 1e 1c 49 08 70
		1c 48 00 68 00 28 04 d0 1a 48 00 68 40 1e 19 49 08 60 19 48 00 68 00 28 04 d0 17 48 00 68 40 1e
		15 49 08 60 15 48 00 78 40 1c 14 49 08 70 08 46 00 78 c8 28 0e dd 00 20 08 70 11 48 00 78 00 28
		05 d0 00 20 01 f0 70 fa 01 20 0e 49 08 70 01 20 0b 49 08 70 10 bd 00 00 3a 01 00 20 3c 01 00 20
		3e 01 00 20 40 01 00 20 44 01 00 20 48 01 00 20 4c 01 00 20 50 01 00 20 54 01 00 20 38 01 00 20
		24 01 00 20 10 01 00 20 04 48 00 69 00 28 04 d0 01 20 02 49 48 61 76 20 c8 60 70 47 00 00 01 40
		20 21 02 0c 01 d0 10 21 10 46 02 0a 01 d0 10 46 08 39 02 09 01 d0 10 46 09 1f 82 08 01 d0 10 46
		89 1e 42 08 01 d0 88 1e 70 47 08 1a 70 47 30 b4 74 46 64 1e 25 78 64 1c ab 42 04 d3 63 5d 5b 00
		e3 18 30 bc 18 47 1d 46 f8 e7 02 e0 08 c8 12 1f 08 c1 00 2a fa d1 70 47 70 47 00 20 01 e0 01 c1
		12 1f 00 2a fb d1 70 47 10 b5 fe 48 00 78 08 28 0b da 01 f0 1f fa fc 49 fa 4a 12 78 88 54 f9 48
		00 78 40 1c f7 49 08 70 10 bd f6 48 00 78 08 28 29 d1 09 20 f3 49 08 70 02 f0 8a fa f2 48 00 78
		01 28 21 d1 f0 48 40 78 00 28 1d d1 ee 48 80 78 01 28 19 d1 ec 48 c0 78 c0 00 eb 49 09 79 89 00
		08 43 e9 49 49 79 49 00 08 43 e7 49 89 79 08 43 e6 49 08 70 00 20 e6 49 08 70 e6 48 00 78 00 28
		d6 d1 e5 49 08 70 8f e0 df 48 00 78 01 28 20 d1 dd 48 40 78 00 28 1c d1 db 48 80 78 00 28 18 d1
		d9 48 c0 78 c0 00 d8 49 09 79 89 00 08 43 d6 49 49 79 49 00 08 43 d4 49 89 79 08 43 d3 49 08 70
		00 20 d3 49 08 70 d3 49 08 70 02 20 d2 49 08 70 6a e0 cd 48 40 78 01 28 21 d1 cb 48 80 78 00 28
		1d d1 c9 48 c0 78 01 28 19 d1 c7 48 00 79 c0 00 c5 49 49 79 89 00 08 43 c3 49 89 79 49 00 08 43
		c1 49 c9 79 08 43 c1 49 08 70 00 20 c0 49 08 70 c0 48 00 78 00 28 01 d1 bf 49 08 70 84 e7 ba 48
		40 78 01 28 20 d1 b8 48 80 78 00 28 1c d1 b6 48 c0 78 00 28 18 d1 b4 48 00 79 c0 00 b2 49 49 79
		89 00 08 43 b0 49 89 79 49 00 08 43 ae 49 c9 79 08 43 ae 49 08 70 00 20 ad 49 08 70 ad 49 08 70
		02 20 ad 49 08 70 5f e7 a7 48 c0 78 c0 00 a6 49 09 79 89 00 08 43 a4 49 49 79 49 00 08 43 a2 49
		89 79 08 43 a1 49 08 70 02 20 a3 49 08 70 a0 48 00 78 00 28 05 d1 9e 48 00 78 40 1c 9c 49 08 70
		02 e0 01 20 9d 49 08 70 9d 48 00 78 00 28 14 d1 9c 49 c8 70 08 71 48 71 88 71 c8 71 08 72 48 72
		99 48 00 78 02 28 09 d1 90 48 00 78 00 07 00 0e 96 49 08 70 01 20 93 49 48 71 41 e2 92 48 00 78
		01 28 0a d1 91 48 00 78 88 49 09 78 08 43 8f 49 08 70 01 20 8b 49 48 71 32 e2 8d 48 00 78 05 28
		16 d1 88 48 80 7a 87 49 c8 70 08 46 c0 7a 08 71 08 46 00 7b 48 71 08 46 40 7b 88 71 08 46 80 7b
		c8 71 08 46 c0 7b 08 72 08 46 00 7c 48 72 17 e2 7f 48 00 78 04 28 09 d1 74 48 00 78 00 07 00 0c
		7c 49 08 80 01 20 77 49 48 71 09 e2 78 48 00 78 03 28 0b d1 6d 48 00 78 00 02 76 49 09 88 08 43
		74 49 08 80 01 20 6f 49 48 71 f9 e1 70 48 00 78 02 28 0b d1 65 48 00 78 00 01 6e 49 09 88 08 43
		6c 49 08 80 01 20 67 49 48 71 e9 e1 68 48 00 78 01 28 15 d1 67 48 00 88 5c 49 09 78 08 43 65 49
		08 80 00 f0 a3 fb 01 20 5e 49 48 71 62 48 00 88 60 49 09 88 88 42 90 d1 01 20 60 49 08 70 cf e1
		5f 48 00 78 00 28 4c d0 5d 48 00 78 40 1e c1 00 08 1a 5c 49 09 68 08 5c 52 49 c8 70 58 48 00 78
		40 1e c1 00 08 1a 57 49 09 68 40 18 40 78 4d 49 08 71 53 48 00 78 40 1e c1 00 08 1a 51 49 09 68
		40 18 80 78 47 49 48 71 4d 48 00 78 40 1e c1 00 08 1a 4c 49 09 68 40 18 c0 78 42 49 88 71 48 48
		00 78 40 1e c1 00 08 1a 46 49 09 68 40 18 00 79 3c 49 c8 71 42 48 00 78 40 1e c1 00 08 1a 41 49
		09 68 40 18 40 79 37 49 08 72 3d 48 00 78 40 1e c1 00 08 1a 3b 49 09 68 40 18 80 79 31 49 48 72
		7e e1 2a 48 00 78 09 28 0c d1 00 20 2e 49 08 70 2f 49 08 70 32 49 08 70 01 f0 56 f8 01 20 32 49
		08 70 51 e6 00 20 28 49 08 70 29 49 08 70 2c 49 08 70 1e 48 00 78 03 00 ff f7 19 fe 10 ee 09 84
		a0 d6 ef 20 20 20 20 20 20 f7 eb ea e9 20 27 48 00 78 00 28 13 d0 26 48 00 78 00 28 06 d1 01 20
		18 49 c8 70 08 71 08 72 48 72 02 e0 01 20 15 49 88 71 1f 48 00 78 c0 43 1d 49 08 70 3f e1 1d 48
		00 78 00 28 38 d0 01 20 0e 49 c8 70 08 71 48 71 88 71 c8 71 08 72 48 72 16 48 00 78 40 1e 15 49
		08 70 2c e1 21 01 00 20 19 01 00 20 23 01 00 20 15 01 00 20 60 01 00 20 5f 01 00 20 12 01 00 20
		22 01 00 20 84 01 00 20 25 01 00 20 26 01 00 20 28 01 00 20 2c 01 00 20 2e 01 00 20 30 01 00 20
		29 01 00 20 00 01 00 20 18 01 00 20 37 01 00 20 5e 01 00 20 58 01 00 20 b0 48 00 68 b0 49 88 42
		01 da 00 24 07 e0 ad 49 09 68 ad 4a 88 1a 0a 21 ff f7 9a f8 04 46 60 06 c0 0f aa 49 c8 70 a0 06
		c0 0f 08 71 e0 06 c0 0f 48 71 20 07 c0 0f 88 71 60 07 c0 0f c8 71 a0 07 c0 0f 08 72 e0 07 c0 0f
		48 72 dc e0 03 21 49 03 05 20 00 03 02 f0 ce fa 9d 49 08 70 08 46 00 78 02 28 03 d1 01 20 99 49
		08 71 0a e0 98 48 00 78 01 28 03 d1 95 49 08 71 48 71 02 e0 01 20 93 49 48 71 c0 e0 01 20 93 49
		08 70 93 48 00 78 40 06 c0 0f 8e 49 c8 70 90 48 00 78 80 06 c0 0f 08 71 8d 48 00 78 c0 06 c0 0f
		48 71 8b 48 00 78 00 07 c0 0f 88 71 88 48 00 78 40 07 c0 0f c8 71 86 48 00 78 80 07 c0 0f 08 72
		83 48 00 78 c0 07 c0 0f 48 72 00 20 81 49 08 70 7f 48 00 78 64 21 48 43 ff 30 2d 30 7e 49 08 80
		0a 20 7e 49 08 70 8a e0 7d 48 00 78 00 28 07 d0 00 20 7c 49 08 70 7a 48 00 78 40 1e 78 49 08 70
		78 48 00 78 6f 49 c8 70 01 20 48 71 77 e0 3e e0 3c e0 22 e0 09 e0 00 e0 37 e0 03 20 72 49 08 70
		01 20 68 49 08 71 88 71 69 e0 70 48 00 78 00 28 03 d0 6f 48 00 78 00 28 00 d1 60 e0 6b 48 00 78
		40 1e 6a 49 08 70 06 20 6a 49 08 70 00 f0 92 ff 69 49 08 70 00 f0 c0 f9 51 e0 68 48 00 78 40 1c
		67 49 08 70 65 48 00 78 80 1c 66 49 08 70 66 48 00 78 54 49 c8 70 65 48 00 78 08 71 64 48 00 78
		48 71 64 48 00 78 88 71 39 e0 01 e0 00 e0 00 bf 61 48 00 78 00 28 2f d0 4c 48 00 78 00 28 2b d0
		5e 48 00 78 03 28 03 d1 01 20 5d 49 08 70 0b e5 5a 48 00 78 40 1c 59 49 08 70 40 49 09 68 40 4a
		88 1a 0a 21 fe f7 c0 ff 04 46 60 06 c0 0f 3d 49 c8 70 a0 06 c0 0f 08 71 e0 06 c0 0f 48 71 20 07
		c0 0f 88 71 60 07 c0 0f c8 71 a0 07 c0 0f 08 72 e0 07 c0 0f 48 72 02 e0 01 f0 f2 ff e4 e4 00 bf
		30 49 48 4a 12 78 88 5c 01 f0 7a ff 45 48 00 78 40 1c 44 49 08 70 08 46 00 78 09 28 4c dd 04 20
		00 f0 ae fa 05 20 00 f0 ab fa 01 f0 53 ff 00 20 3c 49 08 70 3c 49 08 70 3c 49 08 70 2a 48 00 78
		00 28 05 d0 28 48 00 78 40 1e 27 49 08 70 33 e0 28 48 00 78 00 28 05 d0 26 48 00 78 40 1e 25 49
		08 70 29 e0 26 48 00 78 00 28 0a d0 24 48 00 78 40 1e 23 49 08 70 23 48 00 78 40 1e 21 49 08 70
		1a e0 2b 48 00 78 02 28 02 d0 04 28 13 d1 0a e0 0d 48 00 78 01 28 05 d1 12 48 00 78 01 28 01 d1
		00 f0 92 fe 07 e0 01 20 11 49 08 70 00 f0 e2 fe 20 49 08 70 00 bf 00 bf 00 bf 85 e4 0c 01 00 20
		4c 0d 00 00 84 01 00 20 70 01 00 20 14 01 00 20 59 01 00 20 58 01 00 20 62 01 00 20 64 01 00 20
		60 01 00 20 17 01 00 20 25 01 00 20 27 01 00 20 34 01 00 20 28 01 00 20 36 01 00 20 04 01 00 20
		29 01 00 20 2a 01 00 20 06 01 00 20 07 01 00 20 08 01 00 20 09 01 00 20 67 01 00 20 16 01 00 20
		13 01 00 20 22 01 00 20 21 01 00 20 24 01 00 20 23 01 00 20 35 01 00 20 10 b5 5d 48 00 78 08 28
		0b da 00 f0 57 fe 5b 49 59 4a 12 78 88 54 58 48 00 78 40 1c 56 49 08 70 10 bd 55 48 00 78 08 28
		61 d1 09 20 52 49 08 70 01 f0 c2 fe 51 48 00 78 01 28 1b d1 4f 48 40 78 00 28 17 d1 4d 48 80 78
		01 28 13 d1 4b 48 c0 78 c0 00 4a 49 09 79 89 00 08 43 48 49 49 79 49 00 08 43 46 49 89 79 08 43
		45 49 08 70 00 20 45 49 08 70 3c e0 41 48 40 78 01 28 1b d1 3f 48 80 78 00 28 17 d1 3d 48 c0 78
		01 28 13 d1 3b 48 00 79 c0 00 3a 49 49 79 89 00 08 43 38 49 89 79 49 00 08 43 36 49 c9 79 08 43
		35 49 08 70 00 20 35 49 08 70 b5 e7 31 48 c0 78 c0 00 30 49 09 79 89 00 08 43 2e 49 49 79 49 00
		08 43 2c 49 89 79 08 43 2b 49 08 70 2b 48 00 78 00 28 05 d1 29 48 00 78 40 1c 28 49 08 70 02 e0
		01 20 27 49 08 70 27 48 00 78 00 28 22 d1 01 20 25 49 88 70 00 20 c8 70 08 71 48 71 88 71 c8 71
		08 72 48 72 1c 48 00 78 04 28 02 d0 06 28 0c d1 07 e0 1e 48 00 78 1c 49 c8 70 01 20 c8 71 48 72
		07 e0 01 20 18 49 c8 70 03 e0 01 20 18 49 08 70 72 e7 00 bf 14 49 13 4a 12 78 88 5c 01 f0 40 fe
		10 48 00 78 40 1c 0f 49 08 70 08 46 00 78 09 28 0b dd 04 20 00 f0 74 f9 01 f0 1c fe 00 20 09 49
		08 70 03 49 08 70 0b 49 08 70 00 bf 54 e7 00 00 21 01 00 20 19 01 00 20 23 01 00 20 15 01 00 20
		12 01 00 20 22 01 00 20 84 01 00 20 17 01 00 20 13 01 00 20 24 01 00 20 28 48 00 78 40 02 28 49
		09 78 49 00 08 43 27 49 08 80 24 48 00 78 40 06 c0 0f 25 49 48 71 21 48 00 78 80 06 c0 0f c8 72
		1e 48 00 78 c0 06 c0 0f 08 72 1c 48 00 78 00 07 c0 0f 08 74 19 48 00 78 40 07 c0 0f 88 73 17 48
		00 78 80 07 c0 0f 48 73 14 48 00 78 c0 07 c0 0f c8 71 13 48 00 78 40 06 c0 0f c8 70 10 48 00 78
		80 06 c0 0f 08 73 0e 48 00 78 c0 06 c0 0f 08 71 0b 48 00 78 00 07 c0 0f 88 72 09 48 00 78 40 07
		c0 0f 48 72 06 48 00 78 80 07 c0 0f c8 73 04 48 00 78 c0 07 c0 0f 88 71 70 47 00 00 35 01 00 20
		36 01 00 20 2e 01 00 20 84 01 00 20 03 48 00 88 03 49 08 40 01 49 08 80 70 47 00 00 2c 01 00 20
		fe fe 00 00 70 b5 04 46 01 20 00 03 84 42 06 d1 01 f0 9e f8 20 46 01 f0 bb f9 05 46 22 e0 01 20
		40 03 84 42 06 d1 01 f0 93 f8 20 46 01 f0 b0 f9 05 46 17 e0 07 20 00 03 84 42 0c d1 01 f0 88 f8
		20 46 01 f0 a5 f9 05 46 4b 21 c9 00 28 46 02 f0 49 f8 05 46 06 e0 20 46 01 f0 7a f8 20 46 01 f0
		97 f9 05 46 28 46 70 bd 70 47 70 47 38 b5 04 46 6a 46 02 21 20 46 ff f7 a1 f9 69 46 48 78 00 02
		09 78 08 43 05 b2 06 2c 02 d1 02 48 28 18 05 b2 28 46 38 bd 55 f5 ff ff 7c b5 11 a0 00 68 01 90
		01 aa 02 21 3e 20 ff f7 94 f9 00 f0 94 f8 6a 46 04 21 40 20 ff f7 82 f9 68 46 40 78 01 02 68 46
		00 78 01 43 0c 46 68 46 c0 78 00 02 69 46 89 78 08 43 05 46 ac 42 01 da 28 46 7c bd 20 46 fc e7
		71 00 00 00 10 b5 01 20 00 03 ff f7 8b ff 04 46 12 49 ff f7 2f f8 10 d3 01 20 40 03 ff f7 82 ff
		04 46 0e 49 ff f7 26 f8 07 d3 00 20 ff f7 7a ff 04 46 0a 49 ff f7 1e f8 05 d2 09 48 00 78 40 1c
		07 49 08 70 02 e0 00 20 05 49 08 70 04 48 00 78 09 28 01 dd 01 20 10 bd 00 20 fc e7 00 00 53 43
		5d 01 00 20 10 b5 04 46 00 2c 02 d0 00 20 00 f0 53 ff 01 22 11 46 80 20 01 f0 9c fa 00 2c 02 d0
		01 20 00 f0 49 ff 10 bd 10 b5 04 46 00 2c 02 d0 00 20 00 f0 41 ff 01 22 11 46 40 20 01 f0 8a fa
		00 2c 02 d0 01 20 00 f0 37 ff 10 bd 10 b5 00 24 00 bf 03 e0 00 f0 05 f8 60 1c c4 b2 19 2c f9 db
		10 bd 10 b5 00 f0 17 f8 00 f0 15 f8 00 f0 13 f8 00 f0 11 f8 10 bd 10 b5 00 24 0a 24 03 e0 00 f0
		0a f8 60 1e c4 b2 00 2c f9 dc 10 bd 10 b5 03 20 ff f7 b8 f8 10 bd 10 b5 22 20 ff f7 b3 f8 10 bd
		70 b5 04 46 25 46 03 e0 ff f7 f5 ff 68 1e c5 b2 00 2d f9 dc 70 bd 70 47 8a b0 00 20 09 90 08 90
		00 26 00 27 07 90 06 90 05 90 04 90 03 90 02 90 01 90 e1 20 40 01 fe 49 08 80 a5 20 c0 00 fd 49
		08 80 fd 48 fd 49 08 60 fd 49 08 60 0a 20 fd 49 08 70 83 e3 01 f0 94 ff fb 48 00 68 00 28 43 d1
		58 20 01 f0 45 fd 05 46 f8 48 00 78 00 28 36 d1 1f 2d 05 d1 00 f0 e8 fb 01 20 f4 49 08 70 21 e0
		00 2d 03 d1 71 20 01 f0 d3 fc 1b e0 0c 2d 06 dd 10 2d 04 da a8 00 28 18 c0 b2 00 90 12 e0 01 2d
		07 dd 0c 2d 05 da 68 1c 81 00 40 18 c0 b2 00 90 08 e0 0c 2d 02 d1 3f 20 00 90 03 e0 01 2d 01 d1
		0f 20 00 90 e2 48 00 78 00 28 08 d1 e1 48 02 78 e1 48 00 78 00 99 01 f0 7f fc dd 49 08 70 7d 20
		00 01 d9 49 08 60 36 e3 d4 48 00 68 00 28 70 d1 0c 20 ff f7 cb fe 07 46 d8 48 87 42 05 dd ff f7
		6a ff 0c 20 ff f7 c2 fe 07 46 3c 46 00 bf cf 48 00 78 00 28 72 d1 d2 48 84 42 0a da 07 98 40 1c
		c0 b2 07 90 07 98 02 28 05 dd 77 20 01 f0 80 fc 01 e0 00 20 07 90 c9 48 87 42 02 dd 75 20 01 f0
		77 fc c8 48 84 42 0a dd 03 98 40 1c c0 b2 03 90 03 98 02 28 05 dd 74 20 01 f0 6a fc 01 e0 00 20
		03 90 c1 48 00 78 01 28 53 d1 c0 48 00 68 c0 49 88 42 02 dd 05 20 06 90 25 e0 bc 48 00 68 bc 49
		49 1f 88 42 02 dd 04 20 06 90 1c e0 b7 48 00 68 b7 49 14 39 88 42 02 dd 03 20 06 90 13 e0 b3 48
		00 68 b3 49 1e 39 88 42 02 dd 02 20 06 90 0a e0 ae 48 00 68 23 21 c9 01 88 42 02 dd 01 20 06 90
		01 e0 00 20 06 90 ab 48 84 42 03 dd 00 20 05 90 d3 e0 18 e1 a7 48 64 38 84 42 02 dd 01 20 05 90
		cb e0 a4 48 c8 38 84 42 02 dd 02 20 05 90 c4 e0 a1 48 84 42 03 dd 03 20 05 90 be e0 fa e0 9e 48
		64 38 84 42 02 dd 04 20 05 90 b6 e0 05 20 05 90 b3 e0 95 48 00 78 02 28 53 d1 94 48 00 68 94 49
		88 42 02 dd 05 20 06 90 25 e0 90 48 00 68 90 49 49 1f 88 42 02 dd 04 20 06 90 1c e0 8b 48 00 68
		8b 49 14 39 88 42 02 dd 03 20 06 90 13 e0 87 48 00 68 87 49 1e 39 88 42 02 dd 02 20 06 90 0a e0
		82 48 00 68 23 21 c9 01 88 42 02 dd 01 20 06 90 01 e0 00 20 06 90 4b 20 00 01 84 42 02 dd 00 20
		05 90 7a e0 7b 48 32 30 84 42 02 dd 01 20 05 90 73 e0 7d 20 c0 00 84 42 02 dd 02 20 05 90 6c e0
		e1 20 80 00 84 42 02 dd 03 20 05 90 65 e0 19 20 40 01 84 42 02 dd 04 20 05 90 5e e0 05 20 05 90
		5b e0 69 48 00 78 03 28 53 d1 68 48 00 68 6b 49 88 42 02 dd 05 20 06 90 25 e0 64 48 00 68 67 49
		3c 39 88 42 02 dd 04 20 06 90 1c e0 5f 48 00 68 62 49 64 39 88 42 02 dd 03 20 06 90 13 e0 5b 48
		00 68 7d 21 49 01 88 42 02 dd 02 20 06 90 0a e0 56 48 00 68 59 49 a0 39 88 42 02 dd 01 20 06 90
		01 e0 00 20 06 90 53 48 64 38 84 42 02 dd 00 20 05 90 22 e0 19 20 40 01 84 42 02 dd 01 20 05 90
		1b e0 4b 20 c0 00 84 42 02 dd 02 20 05 90 14 e0 ff 20 c3 30 84 42 02 dd 03 20 05 90 0d e0 ff 20
		2d 30 84 42 02 dd 04 20 05 90 06 e0 05 20 05 90 03 e0 00 20 06 90 05 20 05 90 05 99 06 98 40 18
		05 28 0a dd 02 98 40 1c c0 b2 02 90 02 98 05 28 05 dd 5a 20 01 f0 4c fb 01 e0 00 20 02 90 38 48
		00 88 84 42 11 dd 36 48 00 88 36 49 88 42 0c dd 35 48 00 78 00 28 05 d0 33 48 00 78 40 1e 32 49
		08 70 02 e0 55 20 01 f0 33 fb 28 48 00 68 28 49 24 39 88 42 0f dd 2d 48 84 42 0c dd 19 48 00 78
		40 1e 18 49 08 70 08 46 00 78 00 28 06 d1 55 20 01 f0 1e fb 02 e0 0a 20 12 49 08 70 7d 20 c0 00
		0e 49 08 60 a7 e1 22 48 00 68 00 28 7e d1 ff f7 53 fd 06 46 1f 48 86 42 03 dc 7d 20 00 01 86 42
		43 da ff f7 d8 fd ff f7 47 fd 06 46 19 48 33 e0 3c 01 00 20 3e 01 00 20 20 4e 00 00 44 01 00 20
		50 01 00 20 65 01 00 20 48 01 00 20 37 01 00 20 58 01 00 20 33 01 00 20 5a 01 00 20 10 27 00 00
		30 f8 ff ff 34 21 00 00 0b 01 00 20 0c 01 00 20 a8 11 00 00 1a 04 00 00 ee 02 00 00 22 10 00 00
		62 01 00 20 fc 08 00 00 64 01 00 20 e4 0c 00 00 40 01 00 20 88 13 00 00 86 42 03 dc 7d 20 00 01
		86 42 02 da 76 20 01 f0 c3 fa ad 48 06 60 ad 48 00 78 00 28 7e d1 ac 48 00 88 00 28 07 d1 ab 48
		00 78 49 28 1d dd 49 20 a8 49 08 70 19 e0 a6 48 00 88 c3 21 89 00 88 42 07 da a4 48 00 78 49 28
		0f dd 49 20 a1 49 08 70 0b e0 9f 48 00 88 a0 49 88 42 06 da 9d 48 00 78 49 28 02 dd 49 20 9b 49
		08 70 9c 48 00 78 00 28 1b d1 00 e0 9f e0 94 48 00 68 99 49 88 42 07 dd 94 48 00 78 49 28 10 dd
		49 20 92 49 08 70 0c e0 8d 48 00 68 92 49 fa 39 88 42 06 dd 8d 48 00 78 49 28 02 dd 49 20 8b 49
		08 70 87 48 00 68 8c 49 96 39 88 42 07 dd 87 48 00 78 49 28 1e dd 49 20 84 49 08 70 1a e0 80 48
		00 68 21 21 c9 01 88 42 07 dd 80 48 00 78 49 28 10 dd 49 20 7d 49 08 70 0c e0 79 48 00 68 7e 49
		e6 39 88 42 06 dd 79 48 00 78 49 28 02 dd 49 20 76 49 08 70 79 48 00 78 00 28 09 d1 78 48 02 78
		78 48 01 78 71 48 00 78 01 f0 16 fa 73 49 08 70 75 48 00 e0 43 e0 00 78 02 28 08 d1 68 48 00 68
		6d 49 0a 31 88 42 02 dd 5a 20 01 f0 31 fa 6f 48 00 78 01 28 1a d1 62 48 00 68 6d 49 88 42 02 dd
		5a 20 01 f0 25 fa 5e 48 00 68 69 49 0a 39 88 42 0a dd 08 98 40 1c c0 b2 08 90 08 98 05 28 05 dd
		5a 20 01 f0 15 fa 01 e0 00 20 08 90 54 48 00 68 59 49 50 31 88 42 02 dd 5a 20 01 f0 09 fa 50 48
		00 68 55 49 46 31 88 42 0a dd 09 98 40 1c c0 b2 09 90 09 98 05 28 05 dd 5a 20 01 f0 f9 f9 01 e0
		00 20 09 90 ff 20 f5 30 52 49 08 60 83 e0 52 48 00 68 00 28 2a d1 06 20 ff f7 18 fc 04 46 41 48
		00 78 00 28 1d d1 00 2c 0e dd 48 48 00 78 00 28 03 d1 ff 20 f5 30 84 42 06 dc 44 48 00 78 01 28
		0d d1 46 48 84 42 0a dd 04 98 40 1c c0 b2 04 90 04 98 02 28 05 dd 5c 20 01 f0 ca f9 01 e0 00 20
		04 90 ff 20 f5 30 3c 49 08 60 54 e0 3c 48 00 68 00 28 1e d1 2b 48 00 78 00 28 0e d1 ff f7 22 fc
		00 28 05 d0 00 20 00 f0 bf f8 01 20 25 49 08 70 19 20 40 01 32 49 08 60 3d e0 01 98 00 28 04 d1
		5d 20 01 f0 05 fa 01 20 01 90 2e 48 2c 49 08 60 31 e0 2d 48 00 78 00 28 2d d1 2c 48 00 88 00 28
		06 d1 18 48 00 78 00 28 02 d1 5a 20 01 f0 90 f9 27 48 00 78 00 28 02 d0 59 20 01 f0 89 f9 25 48
		00 78 00 28 02 d0 73 20 01 f0 82 f9 22 48 00 78 00 28 02 d0 72 20 01 f0 7b f9 20 48 00 78 00 28
		03 d1 1f 48 00 78 01 28 02 dd 54 20 01 f0 70 f9 14 20 15 49 08 70 2f 20 ff f7 52 fc 7a e4 00 00
		0c 01 00 20 37 01 00 20 3e 01 00 20 5a 01 00 20 74 04 00 00 5b 01 00 20 62 11 00 00 58 01 00 20
		33 01 00 20 32 01 00 20 66 01 00 20 0a 01 00 20 2c 10 00 00 40 01 00 20 50 01 00 20 26 02 00 00
		54 01 00 20 10 27 00 00 4c 01 00 20 3c 01 00 20 18 01 00 20 13 01 00 20 12 01 00 20 10 01 00 20
		61 01 00 20 30 e0 01 f0 db fb 18 48 00 68 00 28 0a d1 58 20 01 f0 8c f9 00 28 01 d1 01 f0 38 f9
		13 48 12 49 08 60 1f e0 12 48 00 78 00 28 1b d1 11 48 00 78 00 28 02 d0 73 20 01 f0 19 f9 0f 48
		00 78 00 28 02 d0 72 20 01 f0 12 f9 0c 48 00 78 00 28 03 d1 0b 48 00 78 01 28 02 dd 54 20 01 f0
		07 f9 14 20 03 49 08 70 cd e7 00 00 48 01 00 20 70 17 00 00 4c 01 00 20 13 01 00 20 12 01 00 20
		10 01 00 20 61 01 00 20 00 28 03 d0 05 49 06 4a 51 60 03 e0 01 21 09 04 03 4a 51 60 03 49 08 70
		70 47 00 00 01 00 01 00 00 00 05 50 67 01 00 20 70 47 00 00 01 49 48 7c 70 47 00 00 40 00 03 50
		10 b5 20 20 00 f0 42 fe 04 46 20 46 10 bd 00 00 03 48 00 78 00 28 01 d1 01 20 70 47 00 20 fc e7
		67 01 00 20 10 b5 03 20 40 03 00 f0 75 fd 01 49 08 60 10 bd 68 01 00 20 10 b5 01 22 00 21 08 20
		00 f0 cc fd ff f7 97 fb 08 20 00 f0 1f fe 04 46 00 2c 06 d0 01 20 05 49 08 70 64 20 04 49 08 80
		02 e0 00 20 01 49 08 70 10 bd 00 00 6c 01 00 20 6e 01 00 20 10 b5 00 20 00 f0 b0 ff c4 b2 64 06
		64 0e 20 46 10 bd 10 b5 00 21 08 46 00 f0 1a fe 10 bd 00 00 08 b5 01 21 68 46 01 70 00 21 41 70
		02 21 81 70 01 21 c1 70 fe f7 70 fc 01 20 40 07 fd 49 48 60 fd 48 fe 49 88 60 00 f0 87 fa 01 f0
		e3 f9 01 f0 17 fb ff f7 b7 ff fa 48 00 78 01 28 05 d1 03 e0 01 f0 14 fb 00 f0 88 fa fa e7 01 f0
		0f fb 00 f0 74 fa ff f7 ce ff 00 20 ff f7 0c fb 01 20 00 f0 51 fa 53 20 01 f0 42 f9 05 46 2d 07
		2d 0f 00 2d 01 d1 0a 24 16 e0 01 2d 01 d1 3c 24 12 e0 02 2d 01 d1 82 24 0e e0 03 2d 01 d1 aa 24
		0a e0 04 2d 02 d1 ff 24 69 34 05 e0 05 2d 02 d1 ff 24 f5 34 00 e0 0a 24 32 2c 0b db 78 2c 09 da
		dd 48 de 49 08 60 04 20 dd 49 08 70 02 20 dd 49 08 70 4c e0 78 2c 0b db a0 2c 09 da da 48 d7 49
		08 60 06 20 d6 49 08 70 01 20 d8 49 08 70 3e e0 a0 2c 0d db ff 20 5f 30 84 42 09 da d4 48 cf 49
		08 60 08 20 ce 49 08 70 01 20 d0 49 08 70 2e e0 ff 20 5f 30 84 42 0d db ff 20 af 30 84 42 09 da
		cc 48 c6 49 08 60 08 20 c5 49 08 70 02 20 c7 49 08 70 1c e0 ff 20 af 30 84 42 0f db c6 48 84 42
		0c da c6 48 bd 49 08 60 02 20 bd 49 08 70 01 20 c3 49 08 70 03 20 bd 49 08 70 08 e0 c1 48 b7 49
		08 60 04 20 b6 49 08 70 02 20 b6 49 08 70 b4 49 08 78 c1 0f 09 18 49 10 bb 4a 11 70 10 46 00 78
		08 21 08 40 c0 10 b9 49 08 70 10 46 00 78 04 21 08 40 80 10 b6 49 08 70 10 46 00 78 02 21 08 40
		40 10 b4 49 08 70 10 46 00 78 c0 07 c0 0f b2 49 08 70 00 f0 e7 ff 00 f0 fc ff 00 f0 4b ff 00 f0
		19 ff 00 20 ff f7 4e fa 00 bf ff f7 a4 fa 01 f0 57 fa 01 f0 06 f8 00 28 f7 d0 11 e0 01 f0 50 fa
		a6 48 00 78 00 28 01 d0 00 f0 b2 ff a4 48 00 78 01 28 00 d1 05 e0 a3 48 00 78 00 28 00 d1 00 e0
		ec e7 00 bf 52 20 00 f0 f3 ff 05 46 01 20 9e 49 08 70 00 2d 01 d1 00 f0 9b ff 01 f0 31 fa 16 e0
		01 f0 2e fa 95 48 00 78 00 28 02 d0 54 20 00 f0 7f ff 93 48 00 78 01 28 04 d1 94 48 00 78 01 28
		00 d1 05 e0 8f 48 00 78 00 28 00 d1 00 e0 e7 e7 00 bf 01 20 8e 49 08 70 ff f7 96 f9 8d 48 00 78
		00 f0 c6 ff 05 46 02 2d 01 d0 00 f0 71 ff 01 f0 07 fa 01 f0 05 fa 87 48 00 78 00 28 03 d0 ff f7
		9b f9 85 49 08 60 ff f7 11 fa 82 48 00 78 00 28 03 d0 2c 20 ff f7 7a f9 c6 b2 55 2e 27 dd ff 20
		5f 30 84 42 05 db 14 20 7c 49 08 70 7c 49 08 70 8e e0 a0 2c 05 db 14 20 78 49 08 70 78 49 08 70
		86 e0 78 2c 05 db 0f 20 74 49 08 70 74 49 08 70 7e e0 32 2c 05 db 0a 20 70 49 08 70 70 49 08 70
		76 e0 0a 20 6d 49 08 70 6d 49 08 70 70 e0 4b 2e 27 dd ff 20 5f 30 84 42 05 db 1e 20 67 49 08 70
		67 49 08 70 64 e0 a0 2c 05 db 1e 20 63 49 08 70 63 49 08 70 5c e0 78 2c 05 db 19 20 5f 49 08 70
		5f 49 08 70 54 e0 32 2c 05 db 0f 20 5b 49 08 70 5b 49 08 70 4c e0 0a 20 58 49 08 70 58 49 08 70
		46 e0 32 2e 27 dd ff 20 5f 30 84 42 05 db 28 20 52 49 08 70 52 49 08 70 3a e0 a0 2c 05 db 28 20
		4e 49 08 70 4e 49 08 70 32 e0 78 2c 05 db 28 20 4a 49 08 70 4a 49 08 70 2a e0 32 2c 05 db 14 20
		46 49 08 70 46 49 08 70 22 e0 0e 20 43 49 08 70 43 49 08 70 1c e0 a0 2c 05 db 49 20 3f 49 08 70
		3f 49 08 70 14 e0 78 2c 05 db 32 20 3b 49 08 70 3b 49 08 70 0c e0 32 2c 05 db 19 20 37 49 08 70
		37 49 08 70 04 e0 14 20 34 49 08 70 34 49 08 70 23 48 00 78 01 28 04 d1 0c 20 30 49 08 70 30 49
		08 70 ff f7 63 f9 ff f7 dd fd 58 20 00 f0 00 ff 01 20 2c 49 08 70 23 48 00 78 00 28 01 d1 ff f7
		61 fd 0c e0 01 f0 3c f9 1c 48 00 78 00 28 03 d1 1d 48 00 78 01 28 02 dd 54 20 00 f0 89 fe ff f7
		b7 fd 01 28 ee d0 3f e0 00 00 02 50 07 00 47 00 00 00 05 50 6c 01 00 20 44 37 00 21 00 01 00 20
		04 01 00 20 66 01 00 20 60 37 00 21 0b 01 00 20 8a 37 00 21 c2 37 00 21 12 02 00 00 fa 37 00 21
		0a 01 00 20 28 37 00 21 05 01 00 20 06 01 00 20 07 01 00 20 08 01 00 20 09 01 00 20 10 01 00 20
		30 01 00 20 5f 01 00 20 61 01 00 20 2a 01 00 20 31 01 00 20 26 01 00 20 0c 01 00 20 59 01 00 20
		5a 01 00 20 17 01 00 20 ff f7 36 f9 70 b5 02 46 00 29 0a d1 15 4d 16 4e b5 60 ff 25 2d 04 15 43
		14 4e 35 43 12 4e 35 60 13 e0 01 29 11 d1 d5 06 ed 0e 60 26 16 40 76 00 35 43 2a 46 0b 4d 6d 1c
		0b 4e b5 60 ff 25 2d 04 15 43 0a 4e 35 43 08 4e 35 60 07 4d ac 68 01 e0 05 4d ac 68 e5 05 ed 0f
		00 2d f9 d0 02 4d 6b 68 d8 b2 70 bd 01 00 0f 00 00 00 03 40 00 80 00 80 00 28 09 d0 0a 49 09 78
		00 29 05 d1 00 bf 62 b6 00 bf 07 49 08 70 0a e0 00 28 08 d1 04 49 09 78 00 29 04 d0 00 bf 72 b6
		00 bf 01 49 08 70 70 47 72 01 00 20 70 47 10 b5 ff f7 0e fd 00 f0 a0 fd 00 f0 75 fd 00 f0 7a fd
		00 f0 48 fd ff f7 11 f8 10 bd 00 00 fe b5 05 20 00 03 00 f0 91 fa 05 46 64 21 69 43 08 46 35 49
		fd f7 a2 fd 34 49 40 18 87 b2 03 20 40 03 00 f0 83 fa 05 46 64 21 69 43 08 46 2e 49 fd f7 94 fd
		2d 49 40 18 86 b2 01 20 00 03 fe f7 bb ff 00 90 fe f7 16 f8 00 b2 01 90 00 20 fe f7 b3 ff 00 90
		fe f7 0e f8 00 b2 02 90 38 04 30 43 23 49 08 60 02 98 00 04 01 99 08 43 20 49 48 60 08 46 84 68
		20 0c 1f 49 88 42 07 d1 1e 48 00 78 00 28 0a d1 01 20 ff f7 a9 fc 06 e0 1a 48 00 78 01 28 02 d1
		00 20 ff f7 a1 fc ff f7 51 f8 17 48 00 88 00 28 04 dd 15 48 00 88 40 1e 13 49 08 80 12 48 00 88
		00 28 15 d1 0d 48 84 68 a0 b2 00 28 03 d0 0d 48 00 78 00 28 07 d1 0d 48 20 43 08 49 88 60 64 20
		09 49 08 80 04 e0 00 20 ff f7 7e fc 00 f0 80 fd fe bd 00 00 22 02 00 00 70 17 00 00 c0 00 02 50
		a5 a5 00 00 67 01 00 20 6e 01 00 20 ff ff 00 00 f1 b5 82 b0 02 98 01 90 05 21 09 03 01 98 88 42
		2b d1 01 20 80 05 85 49 08 60 01 21 13 20 ff f7 0d ff 07 46 01 21 12 20 ff f7 08 ff 06 46 38 02
		30 43 07 46 38 46 fd f7 94 ff 47 21 09 06 00 90 fd f7 b4 fd 7a 49 08 60 01 21 11 20 ff f7 f6 fe
		04 46 01 21 10 20 ff f7 f1 fe 05 46 21 02 29 43 0c 46 20 b2 73 49 08 80 de e0 03 21 49 03 01 98
		88 42 2b d1 01 20 40 05 6c 49 08 60 01 21 17 20 ff f7 dc fe 07 46 01 21 16 20 ff f7 d7 fe 06 46
		38 02 30 43 07 46 38 46 fd f7 63 ff 47 21 09 06 00 90 fd f7 83 fd 62 49 08 60 01 21 15 20 ff f7
		c5 fe 04 46 01 21 14 20 ff f7 c0 fe 05 46 21 02 29 43 0c 46 20 b2 5b 49 08 80 ad e0 07 21 09 03
		01 98 88 42 4e d1 01 21 1b 20 ff f7 af fe 07 46 01 21 1a 20 ff f7 aa fe 06 46 38 02 30 43 07 46
		38 46 fd f7 36 ff 47 21 09 06 00 90 fd f7 56 fd 4b 49 08 60 01 21 19 20 ff f7 98 fe 04 46 01 21
		18 20 ff f7 93 fe 05 46 20 02 28 43 04 46 20 b2 44 49 08 80 01 21 1f 20 ff f7 88 fe 07 46 01 21
		1e 20 ff f7 83 fe 06 46 38 02 30 43 07 46 38 46 fd f7 0f ff 47 21 09 06 00 90 fd f7 2f fd 3a 49
		08 60 01 21 1d 20 ff f7 71 fe 04 46 01 21 1c 20 ff f7 6c fe 05 46 20 02 28 43 04 46 20 b2 33 49
		08 80 59 e0 01 21 c9 03 01 98 88 42 27 d1 01 21 23 20 ff f7 5b fe 07 46 01 21 22 20 ff f7 56 fe
		06 46 38 02 30 43 07 46 38 46 fd f7 e2 fe 47 21 09 06 00 90 fd f7 02 fd 21 49 08 60 01 21 21 20
		ff f7 44 fe 04 46 01 21 20 20 ff f7 3f fe 05 46 21 02 29 43 0c 46 20 b2 1a 49 08 80 2c e0 01 21
		0f 20 ff f7 33 fe 07 46 01 21 0e 20 ff f7 2e fe 06 46 38 02 30 43 07 46 38 46 fd f7 ba fe 47 21
		09 06 00 90 fd f7 da fc 0d 49 08 60 01 21 0d 20 ff f7 1c fe 04 46 01 21 0c 20 ff f7 17 fe 05 46
		21 02 29 43 0c 46 20 b2 06 49 08 80 7d 20 c0 00 84 42 01 dd 0b 20 08 80 fe bd 00 00 00 00 06 50
		74 01 00 20 7c 01 00 20 78 01 00 20 7e 01 00 20 f1 b5 8c b0 05 20 09 90 0c 9c 6a 48 6a 49 08 60
		0f 20 00 07 20 43 08 60 68 48 80 89 c0 05 c0 0f 01 21 48 40 05 90 65 48 80 89 40 04 c0 0f 04 90
		0b e0 62 48 80 89 c0 05 c0 0f 01 21 48 40 05 90 5e 48 80 89 40 04 c0 0f 04 90 05 98 00 28 f0 d0
		04 98 00 28 ed d0 20 46 00 f0 e8 f8 0b 90 00 27 00 20 0a 90 19 e0 56 48 53 49 08 60 00 bf 52 48
		00 68 02 21 08 40 00 28 f9 d1 4f 48 80 68 01 b2 0a 98 40 00 06 aa 11 52 0a 98 40 00 06 a9 08 5e
		c7 19 0a 98 40 1c c0 b2 0a 90 09 99 0a 98 88 42 e1 db 05 21 38 46 fd f7 b7 fb 07 46 3f b2 07 20
		00 03 84 42 1d d1 43 48 87 42 1a dd 42 49 00 20 08 5e fd f7 23 fe 3a b2 02 90 0b 99 50 1a fd f7
		1d fe 00 90 3d 48 01 68 00 98 fd f7 0a fc 01 90 02 99 fd f7 ad fb 03 90 fd f7 3b fe 05 46 0e 46
		18 e0 37 49 00 20 08 5e fd f7 08 fe 02 90 0b 99 78 1a fd f7 03 fe 00 90 32 48 01 68 00 98 fd f7
		f0 fb 01 90 02 99 fd f7 93 fb 03 90 fd f7 21 fe 05 46 0e 46 05 20 00 03 84 42 07 d0 03 20 40 03
		84 42 03 d0 07 20 00 03 84 42 14 d1 00 22 26 4b 28 46 31 46 fd f7 02 fd 00 22 24 4b 01 91 00 90
		fd f7 64 fd 00 22 20 4b 03 91 02 90 fd f7 44 fc 05 46 0e 46 20 e0 01 20 c0 03 84 42 0e d1 00 22
		1b 4b 28 46 31 46 fd f7 e9 fc 00 22 17 4b 03 91 02 90 fd f7 4b fd 05 46 0e 46 0d e0 00 22 15 4b
		28 46 31 46 fd f7 da fc 00 22 10 4b 03 91 02 90 fd f7 3c fd 05 46 0e 46 28 46 31 46 fd f7 ed fd
		0d b0 f0 bd 01 00 01 00 00 00 06 50 00 00 05 50 02 00 02 00 77 37 00 00 7e 01 00 20 78 01 00 20
		7c 01 00 20 74 01 00 20 00 70 a7 40 00 00 e0 40 00 00 59 40 00 c0 a2 40 10 b5 01 46 0b 46 0c 48
		0c 4c 20 60 80 01 20 60 40 10 20 60 0f 20 00 07 18 43 20 60 00 22 08 48 20 60 00 bf 05 48 00 68
		02 24 20 40 00 28 f9 d1 02 48 82 68 10 b2 10 bd 01 00 01 00 00 00 06 50 02 00 02 00 01 46 05 22
		12 03 91 42 07 d0 03 22 52 03 91 42 03 d0 07 22 12 03 91 42 03 d1 0c 4a 0c 4b 1a 60 02 e0 0c 4a
		0a 4b 1a 60 0b 4a 09 4b 1a 60 00 bf 07 4a 12 68 02 23 1a 40 00 2a f9 d1 04 4a 92 68 10 b2 03 22
		52 06 02 4b 1a 60 70 47 00 04 00 04 00 00 06 50 00 02 00 02 02 00 02 00 01 49 08 73 70 47 00 00
		40 00 03 50 04 49 09 78 09 02 01 43 02 4a 12 78 11 43 08 46 70 47 00 00 40 00 03 50 70 b5 0b 46
		14 46 00 2b 05 d0 11 4d 2d 79 05 43 0f 4e 35 71 1b e0 05 04 05 43 0e 4e 35 60 0c 4d 2d 79 85 43
		0a 4e 35 71 00 21 0e e0 01 25 8d 40 05 40 00 2d 08 d0 4a 00 25 46 95 40 03 26 96 40 36 04 35 43
		03 4e 75 60 49 1c 07 29 ee db 70 bd 00 00 03 50 40 00 02 50 10 b5 14 4b 1b 7d 83 43 12 4c 23 75
		00 29 04 d0 23 46 1b 7e 03 43 23 76 04 e0 0e 4b 1b 7e 83 43 0c 4c 23 76 00 2a 05 d0 0a 4b 1b 7f
		03 43 09 4c 23 77 04 e0 07 4b 1b 7f 83 43 06 4c 23 77 ff 23 04 4c 20 34 23 72 03 4b 1b 7c 03 43
		01 4c 23 74 10 bd 00 00 20 00 03 50 01 46 04 48 00 7c 08 40 00 28 01 d0 01 20 70 47 00 20 fc e7
		40 00 03 50 00 29 05 d0 05 4a 12 78 02 43 04 4b 1a 70 04 e0 02 4a 12 78 82 43 01 4b 1a 70 70 47
		00 00 03 50 f8 b5 06 46 0c 46 19 48 19 49 08 63 00 12 48 63 0a 20 fd f7 fe fd 01 20 00 06 15 49
		08 63 00 12 48 63 0a 20 fd f7 f5 fd 07 27 3f 06 00 2e 11 d1 03 25 2d 02 00 2c 03 d1 0e 48 0f 49
		48 60 0b e0 01 2c 03 d1 0d 48 0c 49 48 60 05 e0 0b 48 0a 49 48 60 01 e0 ff 25 01 35 01 20 c0 05
		06 49 08 60 38 46 28 43 06 49 48 60 f8 bd 00 00 00 01 00 01 00 00 01 50 08 00 08 00 00 00 02 40
		01 00 01 00 00 00 02 50 f8 b5 04 46 0d 46 16 46 1f 46 01 20 3b 46 32 46 29 46 00 90 20 46 00 f0
		01 f8 f8 bd ff b5 81 b0 0d 46 16 46 1f 46 3c 46 1c e0 20 2c 13 dd 20 23 32 46 29 46 01 98 00 f0
		17 f8 00 28 02 d0 01 20 05 b0 f0 bd 20 36 20 3c 0a 98 00 28 0a d0 28 46 20 30 c5 b2 06 e0 23 46
		32 46 29 46 01 98 00 f0 03 f8 ed e7 e1 e7 00 00 ff b5 0d 46 00 98 40 06 06 0e 20 2b 02 dd 01 20
		04 b0 f0 bd 28 02 30 43 28 4f 38 60 28 48 29 4f 38 60 02 20 38 61 00 bf 26 48 00 6a 02 28 fb d1
		01 20 30 43 21 4f 38 60 21 48 22 4f 38 60 01 20 38 61 00 bf 1f 48 00 6a 01 28 fb d1 1e 48 1d 4f
		38 60 38 46 43 61 00 bf 1a 48 00 6a 98 42 fb d1 19 48 14 38 17 4f 38 60 00 24 15 e0 17 48 a7 10
		bf 00 c1 59 11 70 52 1c ff 20 00 02 08 40 00 0a 10 70 52 1c ff 20 00 04 08 40 00 0c 10 70 52 1c
		08 0e 10 70 52 1c 24 1d 9c 42 e7 db 00 bf 09 48 c0 69 20 27 38 40 20 28 f9 d1 00 20 c0 43 05 4f
		f8 61 07 48 38 60 00 20 aa e7 00 00 00 01 02 40 09 00 ff 00 00 00 02 40 25 00 7f 00 00 02 02 40
		00 00 ff 07 f8 b5 04 46 0d 46 16 46 1f 46 01 20 3b 46 32 46 29 46 00 90 20 46 00 f0 01 f8 f8 bd
		ff b5 81 b0 0d 46 16 46 1f 46 3c 46 1c e0 1e 2c 13 dd 1e 23 32 46 29 46 01 98 00 f0 17 f8 00 28
		02 d0 01 20 05 b0 f0 bd 1e 36 1e 3c 0a 98 00 28 0a d0 28 46 1e 30 c5 b2 06 e0 23 46 32 46 29 46
		01 98 00 f0 03 f8 ed e7 e1 e7 00 00 ff b5 81 b0 0d 46 01 98 40 06 00 0e 00 90 00 26 1c 46 1e 2b
		01 dc 00 2b 02 d1 01 20 05 b0 f0 bd 28 02 00 9f 38 43 01 46 10 78 52 1c 00 04 01 43 01 2b 03 d0
		10 78 52 1c 00 06 01 43 24 48 01 60 02 2c 27 dd a4 1e 14 e0 24 1f 00 21 11 78 52 1c 10 78 52 1c
		00 02 01 43 10 78 52 1c 00 04 01 43 10 78 52 1c 00 06 01 43 19 48 00 1d b7 00 c1 51 76 1c 04 2c
		e8 dc 10 78 57 78 3f 02 38 43 97 78 3f 04 38 43 d7 78 3f 06 38 43 01 46 10 48 00 1d b7 00 c1 51
		0f 48 10 4f 38 60 98 1c 38 61 00 bf 0d 48 00 6a 9f 1c b8 42 fa d1 0a 48 08 30 0a 4f 38 60 00 bf
		08 48 c0 69 20 27 38 40 20 28 f9 d1 00 20 c0 43 04 4f f8 61 04 48 38 60 00 20 a5 e7 00 01 02 40
		09 00 ff 00 00 00 02 40 00 00 ff 01 42 01 02 4b d1 18 01 22 8a 61 70 47 00 00 04 50 01 46 48 01
		01 4b c2 18 90 68 70 47 00 00 04 50 10 b5 01 46 01 20 4b 01 02 4c 1a 19 13 69 18 40 10 bd 00 00
		00 00 04 50 30 b5 03 46 5c 01 05 4d 60 19 01 60 00 2a 02 d0 04 24 04 61 01 e0 00 24 04 61 30 bd
		00 00 04 50 42 01 03 4b d1 18 0a 69 01 23 1a 43 0a 61 70 47 00 00 04 50 76 20 01 49 c8 60 70 47
		00 00 01 40 0a 4a 50 60 00 22 09 4b 1a 60 00 29 05 d0 1a 46 12 68 02 23 1a 43 05 4b 1a 60 04 4a
		12 68 01 23 1a 43 02 4b 1a 60 76 22 da 60 70 47 00 00 01 40 10 b5 07 48 07 49 88 60 00 22 11 46
		80 20 ff f7 ab fd 00 22 11 46 01 20 ff f7 a6 fd 10 bd 00 00 01 00 01 00 40 00 02 50 10 b5 00 22
		01 21 80 20 ff f7 9a fd 10 bd 10 b5 04 46 00 2c 04 d0 01 21 80 20 ff f7 f5 fd 03 e0 00 21 80 20
		ff f7 f0 fd 10 bd 10 b5 02 22 00 21 40 20 ff f7 85 fd 10 bd 03 48 04 49 88 60 00 20 03 49 48 71
		70 47 00 00 10 00 10 00 40 00 02 50 00 00 03 50 00 20 02 49 48 70 01 20 48 71 70 47 00 00 03 50
		00 28 03 d0 01 21 03 4a 51 70 02 e0 00 21 01 4a 51 70 70 47 00 00 03 50 10 b5 01 22 00 21 20 20
		ff f7 5c fd 10 bd 10 b5 00 21 20 20 ff f7 ba fd 00 22 01 21 20 20 ff f7 51 fd 10 bd 10 b5 04 46
		00 2c 04 d0 01 21 20 20 ff f7 ac fd 03 e0 00 21 20 20 ff f7 a7 fd 10 bd 30 b5 03 46 10 48 04 78
		10 48 00 78 98 42 01 dd 0e 48 03 70 0e 48 01 70 0e 48 02 70 91 42 00 da 0a 46 0a 48 00 78 90 42
		02 dd 07 48 02 70 03 e0 06 48 00 78 04 4d 28 70 03 48 00 78 84 42 01 d0 05 20 30 bd 00 20 fc e7
		59 01 00 20 5a 01 00 20 32 01 00 20 33 01 00 20 10 b5 04 46 00 f0 a4 fa 00 20 fe f7 05 ff ff f7
		89 ff 20 46 00 f0 54 f8 00 f0 02 f8 10 bd 00 00 01 48 02 49 08 60 70 47 b9 fd 00 00 40 00 01 50
		10 b5 07 48 00 78 02 28 09 d0 05 48 00 78 01 28 03 d1 02 20 02 49 08 70 01 e0 ff f7 e9 ff 10 bd
		61 01 00 20 10 b5 00 24 ff f7 48 ff 00 bf 0d e0 00 20 ff f7 4a ff 01 20 fe f7 b2 fa 01 20 ff f7
		44 ff 03 20 fe f7 ac fa 60 1c c4 b2 1e 2c ef db 10 bd 08 b5 03 21 68 46 01 70 00 21 41 70 03 21
		81 70 01 21 c1 70 fd f7 a1 fb 01 22 7d 21 c9 01 00 20 ff f7 d7 fe 08 bd 10 b5 00 20 ff f7 e2 fe
		10 bd 10 b5 00 20 ff f7 c1 fe 04 46 20 46 10 bd fe b5 05 46 00 27 00 f0 43 fa 01 95 00 20 3e 49
		08 70 ff f7 50 ff fe f7 71 fa 00 20 ff f7 56 ff fe f7 4c fa 01 20 ff f7 51 ff 00 24 1f e0 37 48
		00 78 00 28 03 d0 58 2d 01 d1 ff f7 13 ff 00 f0 27 fa 00 bf 30 48 00 78 00 28 fb d0 00 f0 20 fa
		06 20 01 1b 01 98 08 41 c0 07 c0 0f 00 90 00 98 ff f7 34 ff 00 20 28 49 08 70 60 1c c4 b2 07 2c
		dd db 00 f0 0d fa 00 24 28 e0 24 48 00 78 00 28 03 d0 58 2d 01 d1 ff f7 ed fe 00 f0 01 fa 00 bf
		1d 48 00 78 00 28 fb d0 00 f0 fa f9 00 2c 03 d1 ff f7 02 ff fe f7 2a fa 00 20 17 49 08 70 fe f7
		6f fe 06 46 06 2c 07 d0 00 2c 05 d0 05 20 01 1b 30 46 88 40 38 43 c7 b2 60 1c c4 b2 07 2c d4 db
		00 f0 de f9 00 bf 0c 48 00 78 00 28 fb d0 00 f0 d7 f9 ff f7 e8 fe fe f7 09 fa 00 20 ff f7 ee fe
		00 20 05 49 08 70 fe f7 e1 f9 fe f7 df f9 00 f0 c7 f9 38 46 fe bd 00 00 11 01 00 20 10 01 00 20
		fe b5 05 46 00 27 00 f0 bb f9 01 95 00 20 3c 49 08 70 ff f7 c8 fe fe f7 e9 f9 00 20 ff f7 ce fe
		fe f7 c4 f9 01 20 ff f7 c9 fe 00 24 1f e0 35 48 00 78 00 28 03 d0 58 2d 01 d1 ff f7 8b fe 00 f0
		9f f9 00 bf 2e 48 00 78 00 28 fb d0 00 f0 98 f9 06 20 01 1b 01 98 08 41 c0 07 c0 0f 00 90 00 98
		ff f7 ac fe 00 20 26 49 08 70 60 1c c4 b2 07 2c dd db 00 f0 85 f9 00 24 24 e0 22 48 00 78 00 28
		03 d0 58 2d 01 d1 ff f7 65 fe 00 f0 79 f9 00 bf 1b 48 00 78 00 28 fb d0 00 f0 72 f9 00 2c 03 d1
		ff f7 7a fe fe f7 a2 f9 00 20 15 49 08 70 fe f7 e7 fd 06 46 06 20 01 1b 30 46 88 40 38 43 c7 b2
		60 1c c4 b2 07 2c d8 db 00 f0 5a f9 00 bf 0c 48 00 78 00 28 fb d0 00 f0 53 f9 ff f7 64 fe fe f7
		85 f9 00 20 ff f7 6a fe 00 20 05 49 08 70 fe f7 5d f9 fe f7 5b f9 00 f0 43 f9 38 46 fe bd 00 00
		11 01 00 20 10 01 00 20 00 20 30 49 08 70 30 49 08 70 30 49 08 70 30 49 08 70 30 49 08 70 30 49
		08 70 30 49 08 70 30 49 08 70 30 49 08 70 01 20 2f 49 08 70 00 20 48 70 88 70 2e 49 08 70 2e 49
		08 70 2e 49 08 70 2e 49 08 70 03 20 2d 49 08 70 00 20 2d 49 08 70 2d 49 08 70 2d 49 08 70 2d 49
		08 80 40 1e 2c 49 08 80 00 20 2c 49 08 70 2c 49 08 70 49 20 2b 49 08 70 2b 49 08 70 00 20 2b 49
		08 70 2b 49 08 70 2b 49 08 70 49 20 2a 49 08 70 2a 49 08 70 01 20 2a 49 08 70 2a 49 08 70 00 20
		29 49 08 70 29 49 08 70 02 20 29 49 08 70 03 20 28 49 08 70 00 20 28 49 08 70 28 49 08 70 28 49
		08 70 28 49 08 70 28 49 08 70 70 47 10 01 00 20 17 01 00 20 18 01 00 20 12 01 00 20 13 01 00 20
		14 01 00 20 15 01 00 20 16 01 00 20 21 01 00 20 84 01 00 20 22 01 00 20 24 01 00 20 25 01 00 20
		26 01 00 20 27 01 00 20 28 01 00 20 29 01 00 20 2a 01 00 20 2c 01 00 20 2e 01 00 20 30 01 00 20
		31 01 00 20 32 01 00 20 33 01 00 20 34 01 00 20 37 01 00 20 58 01 00 20 59 01 00 20 5a 01 00 20
		5b 01 00 20 5c 01 00 20 5d 01 00 20 5e 01 00 20 5f 01 00 20 60 01 00 20 61 01 00 20 66 01 00 20
		0a 01 00 20 67 01 00 20 0b 01 00 20 f8 b5 05 46 00 24 00 26 00 27 28 46 ff f7 8e fa 04 46 1c 48
		00 68 24 1a 1b 48 00 68 e1 21 09 01 88 42 01 da 19 4e 77 00 17 48 00 68 18 49 88 42 02 da 16 4e
		77 00 1b e0 13 48 00 68 14 49 64 31 88 42 02 da 11 4e 77 00 12 e0 0f 48 00 68 7d 21 49 01 88 42
		02 da 0d 4e 77 00 09 e0 0a 48 00 68 0c 49 88 42 02 da 09 4e 77 00 01 e0 07 4e 77 00 b4 42 01 da
		00 20 f8 bd bc 42 01 dd 02 20 fa e7 01 20 f8 e7 68 01 00 20 0c 01 00 20 22 02 00 00 74 0e 00 00
		04 10 00 00 fe b5 06 46 0c 46 01 21 44 20 fe f7 4d ff 02 90 02 98 04 28 13 d1 15 48 00 68 fc f7
		cd ff 13 49 01 90 09 68 08 19 fc f7 c7 ff 31 46 00 90 fc f7 b6 fd 07 46 01 99 fc f7 ef fd 05 46
		14 e0 0b 48 00 68 fc f7 b9 ff 09 49 01 90 09 68 09 19 08 46 c8 38 fc f7 b1 ff 31 46 00 90 fc f7
		a0 fd 07 46 01 99 fc f7 d9 fd 05 46 28 46 fe bd 80 01 00 20 10 b5 01 21 00 20 ff f7 a3 fc 10 bd
		10 b5 ff f7 99 fc 10 bd 00 00 00 01 01 01 00 01 00 00 01 01 01 00 00 00 00 01 00 01 00 01 01 00
		01 00 00 01 00 00 01 00 01 00 00 01 00 00 01 01 01 00 00 00 00 01 00 01 00 01 01 00 01 00 00 01
		00 01 00 01 00 00 00 01 00 00 01 01 01 00 00 00 01 01 01 01 00 01 01 00 01 01 00 00 00 00 00 01
		00 01 01 01 01 00 01 01 01 01 00 01 01 01 01 00 00 01 00 01 00 00 00 00 00 01 00 01 00 00 00 01
		00 01 00 00 01 00 00 00 01 01 01 01 00 01 01 00 01 01 00 00 00 00 00 01 00 01 01 01 01 00 01 01
		01 01 00 01 01 01 01 00 00 01 00 01 00 00 00 00 00 01 00 01 00 00 00 01 00 01 00 00 01 00 00 00
		01 01 01 01 00 01 01 00 01 01 00 00 00 00 00 01 01 00 01 01 01 00 01 01 01 01 00 00 00 01 01 00
		00 01 01 00 01 01 00 00 00 00 00 00 00 00 00 00 00 00 00 00 00 00 00 00 00 00 00 00 00 00 00 00
		00 00 00 00 00 00 00 00 00 00 00 00 00 00 00 00 00 00 00 00 44 38 00 21 00 01 00 20 84 00 00 00
		aa 0b 00 21 00 00 00 00 00 00 00 00 00 00 00 00 00 00 00 00 00 00 00 00 00 00 00 00 00 00 00 00
		00 00 00 00 00 00 00 00 00 00 00 00 00 00 00 00 00 00 00 00 00 00 00 00 00 00 00 00 00 00 00 00
		00 00 00 00 00 00 00 00 00 00 00 00 00 00 00 00 00 00 00 00 00 00 00 00 00 00 00 00 00 00 00 00
		00 00 00 00 00 00 00 00 00 00 00 00 00 00 00 00 00 00 00 00 00 00 00 00 00 00 00 00 00 00 00 00
		00 00 00 00 00 00 00 00 00 00 00 00 00 00 00 00 00 00 00 00 00 00 00 00 00 00 00 00 00 00 00 00
		00 00 00 00 00 00 00 00 00 00 00 00 00 00 00 00 00 00 00 00 00 00 00 00 00 00 00 00 00 00 00 00
		00 00 00 00 00 00 00 00 00 00 00 00 00 00 00 00 00 00 00 00 00 00 00 00 00 00 00 00 00 00 00 00
		00 00 00 00 00 00 00 00 00 00 00 00 00 00 00 00 00 00 00 00 00 02 01 01 02 05 03 00 1d 34 55 34
	];
};

&sy6610_fastcg {
	oplus,firmware_data = [
		20 05 00 20 d5 00 00 00 d5 02 00 00 f5 01 00 00
		00 00 00 00 00 00 00 00 00 00 00 00 00 00 00 00
		00 00 00 00 00 00 00 00 00 00 00 00 e1 00 00 00
		00 00 00 00 00 00 00 00 e3 00 00 00 b1 03 00 00
		e7 00 00 00 e9 00 00 00 eb 00 00 00 ed 00 00 00
		ef 00 00 00 f1 00 00 00 f3 00 00 00 f5 00 00 00
		51 1f 00 00 65 1f 00 00 fb 00 00 00 fd 00 00 00
		ff 00 00 00 01 01 00 00 03 01 00 00 15 28 00 00
		07 01 00 00 6d 1a 00 00 09 20 00 00 d9 29 00 00
		0f 01 00 00 11 01 00 00 13 01 00 00 15 01 00 00
		17 01 00 00 19 01 00 00 1d 01 00 00 1d 01 00 00
		1f 01 00 00 21 01 00 00 23 01 00 00 25 01 00 00
		03 48 85 46 00 f0 84 f8 00 48 00 47 b5 20 00 00
		20 05 00 20 14 48 80 47 14 48 00 47 fe e7 fe e7
		fe e7 fe e7 fe e7 fe e7 fe e7 fe e7 fe e7 fe e7
		fe e7 fe e7 fe e7 fe e7 fe e7 fe e7 fe e7 fe e7
		fe e7 fe e7 fe e7 fe e7 fe e7 fe e7 fe e7 fe e7
		fe e7 fe e7 fe e7 fe e7 fe e7 fe e7 fe e7 fe e7
		fe e7 fe e7 fe e7 00 00 c9 03 00 00 c1 00 00 00
		30 b5 0b 46 01 46 00 20 20 22 01 24 09 e0 0d 46
		d5 40 9d 42 05 d3 1d 46 95 40 49 1b 25 46 95 40
		40 19 15 46 52 1e 00 2d f1 dc 30 bd 70 b5 00 24
		25 46 00 28 01 da 01 24 40 42 00 29 01 da 01 25
		49 42 ff f7 dd ff ac 42 00 d0 40 42 00 2c 00 d0
		49 42 70 bd d2 b2 01 e0 02 70 40 1c 49 1e fb d2
		70 47 00 22 f6 e7 10 b5 13 46 0a 46 04 46 19 46
		ff f7 f0 ff 20 46 10 bd 03 21 00 1d 40 1e 03 78
		12 02 1a 43 49 1e f9 d5 10 46 70 47 03 46 03 22
		08 70 00 0a 49 1c 52 1e fa d5 18 46 70 47 00 00
		06 4c 01 25 06 4e 05 e0 e3 68 07 cc 2b 43 0c 3c
		98 47 10 34 b4 42 f7 d3 ff f7 6e ff c4 2f 00 00
		e4 2f 00 00 04 20 71 46 08 42 02 d1 ef f3 08 80
		01 e0 ef f3 09 80 00 00 00 4a 10 47 99 02 00 00
		00 20 00 bf 72 b6 00 bf 04 49 09 68 01 22 12 03
		11 40 08 0b 00 bf 62 b6 00 bf 70 47 00 00 01 40
		10 b5 01 f0 6d fc 04 46 10 20 20 40 00 28 17 d0
		04 20 01 f0 2f fc 10 48 00 68 00 28 07 d1 02 f0
		53 fc 00 20 0d 49 08 70 01 20 0b 49 08 60 0c 48
		00 78 02 28 02 d1 00 f0 f3 fb 01 e0 00 f0 42 ff
		01 20 80 02 20 40 00 28 05 d0 0a 20 01 f0 12 fc
		01 20 04 49 08 70 10 bd 9c 00 00 20 5e 00 00 20
		87 00 00 20 3d 00 00 20 00 bf fe e7 70 b5 04 46
		0d 46 16 46 33 46 2a 46 21 46 55 20 01 f0 52 fc
		00 20 70 bd f8 b5 05 46 0f 46 14 46 20 78 61 78
		09 02 08 43 06 46 32 46 29 46 55 20 01 f0 56 fd
		00 20 f8 bd 70 47 00 00 00 bf 72 b6 00 bf 05 48
		00 69 01 21 09 03 88 43 02 49 08 61 00 bf 62 b6
		00 bf 70 47 00 00 01 40 00 bf 72 b6 00 bf 08 48
		40 68 01 21 09 03 88 43 05 49 48 60 08 46 00 69
		89 14 08 43 02 49 08 61 00 bf 62 b6 00 bf 70 47
		00 00 01 40 00 bf 72 b6 00 bf 05 48 00 69 01 21
		09 03 88 43 02 49 08 61 00 bf 62 b6 00 bf 70 47
		00 00 01 40 00 bf 72 b6 00 bf 05 48 00 69 01 21
		c9 02 88 43 02 49 08 61 00 bf 62 b6 00 bf 70 47
		00 00 01 40 00 bf 72 b6 00 bf 08 48 40 68 01 21
		c9 02 88 43 05 49 48 60 08 46 00 69 c9 14 08 43
		02 49 08 61 00 bf 62 b6 00 bf 70 47 00 00 01 40
		00 bf 72 b6 00 bf 05 48 00 69 01 21 c9 02 88 43
		02 49 08 61 00 bf 62 b6 00 bf 70 47 00 00 01 40
		04 48 00 68 00 28 04 d0 02 48 00 68 40 1e 01 49
		08 60 70 47 a8 00 00 20 70 47 00 00 10 b5 37 48
		00 88 00 28 05 d0 35 48 00 88 40 1e 33 49 08 80
		15 e0 7d 20 c0 00 31 49 08 80 31 48 00 88 00 28
		04 d0 2f 48 00 88 40 1e 2d 49 08 80 2d 48 00 88
		00 28 04 d0 2b 48 00 88 40 1e 2a 49 08 80 2a 48
		00 68 00 28 04 d0 28 48 00 68 40 1e 26 49 08 60
		26 48 00 68 00 28 04 d0 24 48 00 68 40 1e 23 49
		08 60 23 48 00 68 00 28 04 d0 21 48 00 68 40 1e
		1f 49 08 60 1f 48 00 78 00 28 04 d0 1d 48 00 78
		40 1e 1c 49 08 70 1c 48 00 68 00 28 04 d0 1a 48
		00 68 40 1e 18 49 08 60 18 48 00 68 00 28 04 d0
		16 48 00 68 40 1e 15 49 08 60 15 48 00 78 40 1c
		13 49 08 70 08 46 00 78 c8 28 0e dd 00 20 08 70
		10 48 00 78 00 28 05 d0 00 20 01 f0 5f fa 01 20
		0d 49 08 70 01 20 0b 49 08 70 10 bd 60 00 00 20
		62 00 00 20 64 00 00 20 68 00 00 20 6c 00 00 20
		70 00 00 20 74 00 00 20 78 00 00 20 7c 00 00 20
		5e 00 00 20 4b 00 00 20 3c 00 00 20 30 b4 74 46
		64 1e 25 78 64 1c ab 42 04 d3 63 5d 5b 00 e3 18
		30 bc 18 47 1d 46 f8 e7 00 28 05 db c2 06 d2 0e
		01 21 91 40 01 4a 11 60 70 47 00 00 00 e1 00 e0
		10 b5 00 28 19 db 1a 4a 03 23 1b 02 d2 18 83 08
		9b 00 d2 58 83 07 dc 0e ff 23 a3 40 9a 43 8b 07
		1b 0e 84 07 e4 0e a3 40 1a 43 11 4b 03 24 24 02
		1b 19 84 08 a4 00 1a 51 18 e0 0e 4a 03 07 1b 0f
		08 3b 9b 08 9b 00 d2 58 83 07 dc 0e ff 23 a3 40
		9a 43 8b 07 1b 0e 84 07 e4 0e a3 40 1a 43 05 4b
		04 07 24 0f 08 3c a4 08 a4 00 1a 51 10 bd 00 00
		00 e1 00 e0 1c ed 00 e0 10 b5 00 28 19 db 1a 4a
		03 23 1b 02 d2 18 83 08 9b 00 d2 58 83 07 dc 0e
		ff 23 a3 40 9a 43 8b 07 1b 0e 84 07 e4 0e a3 40
		1a 43 11 4b 03 24 24 02 1b 19 84 08 a4 00 1a 51
		18 e0 0e 4a 03 07 1b 0f 08 3b 9b 08 9b 00 d2 58
		83 07 dc 0e ff 23 a3 40 9a 43 8b 07 1b 0e 84 07
		e4 0e a3 40 1a 43 05 4b 04 07 24 0f 08 3c a4 08
		a4 00 1a 51 10 bd 00 00 00 e1 00 e0 1c ed 00 e0
		02 e0 08 c8 12 1f 08 c1 00 2a fa d1 70 47 70 47
		00 20 01 e0 01 c1 12 1f 00 2a fb d1 70 47 00 00
		30 b5 42 68 0d 4c d5 02 23 46 10 33 e2 68 00 2d
		09 da d3 5c 43 67 52 1c e2 60 03 22 0a 70 01 21
		61 70 89 1e 07 e0 05 6f d5 54 e2 68 52 1c e2 60
		04 22 0a 70 11 04 41 60 00 20 30 bd ec 00 00 20
		10 b5 42 68 12 03 0a d5 08 4c 23 46 e2 68 10 33
		d3 5c 43 67 52 1c e2 60 01 22 d2 04 42 60 40 68
		c0 01 01 d5 05 20 08 70 00 20 10 bd ec 00 00 20
		70 b5 42 68 05 24 52 03 00 2a 16 da 0e 4b da 68
		04 2a 0a d2 05 6f 1e 46 10 36 95 55 da 68 52 1c
		da 60 01 22 92 04 42 60 07 e0 08 4a 55 6f 96 15
		35 43 55 67 0c 70 02 22 5a 70 40 68 c0 01 00 d5
		0c 70 00 20 70 bd 00 00 ec 00 00 20 00 c0 00 40
		70 b5 42 68 0d 4b 0e 4c 52 03 08 d5 05 6f 62 68
		9e 18 35 72 52 1c 62 60 01 22 92 04 42 60 58 68
		62 68 90 42 07 d1 02 20 08 70 00 20 60 60 05 49
		18 69 40 18 18 61 00 20 70 bd 00 00 ec 00 00 20
		0c 00 00 20 02 02 02 02 42 68 d2 02 03 d5 00 21
		c9 43 41 60 07 e0 42 68 52 03 06 d5 01 22 92 04
		42 60 01 20 08 70 00 20 70 47 01 20 70 47 00 00
		00 b5 40 68 0b 46 c0 01 06 d5 01 f0 77 fc 00 20
		02 49 18 70 48 70 c8 60 02 20 00 bd ec 00 00 20
		f8 b5 05 46 0f 46 ff f7 0b fe 07 26 3c e0 00 24
		ff f7 d0 fd 09 e0 4b 20 80 01 84 42 04 d3 ff f7
		ff fd ff f7 c7 fd f8 bd 64 1c ff f7 39 fd 00 28
		f1 d0 00 bf 00 20 00 bf 00 bf 72 b6 00 bf 2a 49
		09 68 01 22 d2 02 11 40 c8 0a 00 bf 62 b6 00 bf
		b0 40 29 78 08 43 28 70 ff f7 96 fd 00 bf 00 bf
		00 bf 00 bf 00 bf 00 bf 00 bf 00 bf 00 bf 00 bf
		00 bf 00 bf 00 bf 00 bf 00 bf 00 bf 00 bf 00 bf
		00 bf 00 bf 00 bf 76 1e 00 2e c0 da 00 2f 02 d0
		ff f7 a0 fd 11 e0 ff f7 ad fd 00 bf 00 bf 00 bf
		72 b6 00 bf 10 48 00 69 01 21 c9 02 08 43 0e 49
		08 61 00 bf 62 b6 00 bf 00 bf 00 24 ff f7 7a fd
		09 e0 4b 20 80 01 84 42 04 d3 ff f7 a9 fd ff f7
		71 fd a8 e7 64 1c ff f7 e3 fc 00 28 f1 d0 ff f7
		53 fd 00 bf 9f e7 00 00 00 00 01 40 f8 b5 06 46
		00 f0 0c fe 07 25 1f e0 01 20 a8 40 30 40 00 28
		02 d0 ff f7 67 fd 01 e0 ff f7 74 fd 00 24 ff f7
		2b fd 0a e0 4b 20 80 01 84 42 05 d3 ff f7 80 fd
		ff f7 48 fd 01 20 f8 bd 64 1c ff f7 b9 fc 00 28
		f0 d0 ff f7 29 fd 6d 1e 00 2d dd da ff f7 70 fd
		00 bf 00 bf 00 bf 00 bf 00 bf 00 bf 00 bf 00 bf
		00 bf 00 bf 00 bf 00 bf 00 24 ff f7 2b fd 0a e0
		4b 20 80 01 84 42 05 d3 ff f7 5a fd ff f7 22 fd
		01 20 d8 e7 64 1c ff f7 93 fc 00 28 f0 d0 00 bf
		01 20 00 bf 00 bf 72 b6 00 bf 06 49 09 68 c2 02
		11 40 c8 0a 00 bf 62 b6 00 bf 07 46 ff f7 f4 fc
		38 46 c0 e7 00 00 01 40 10 b5 ff f7 dd fc 00 bf
		00 bf 00 bf 00 bf 00 bf 00 bf 00 bf 00 bf 00 bf
		00 bf 00 bf 00 bf 00 bf 00 bf 00 bf 00 bf 00 bf
		00 bf 00 bf 00 bf ff f7 0d fd 00 bf 00 bf 00 bf
		00 bf 00 bf 00 bf 00 bf 00 bf 00 bf 00 bf 00 bf
		00 bf ff f7 c9 fc 10 bd 10 b5 ff f7 fb fc 00 bf
		00 bf 00 bf 00 bf 00 bf 00 bf 00 bf 00 bf 00 bf
		00 bf 00 bf ff f7 b8 fc 10 bd 10 b5 00 24 ff f7
		e9 fc 00 bf 00 bf 00 bf 00 bf 00 bf 00 bf 00 bf
		00 bf 00 bf 00 bf 00 bf 00 bf ff f7 95 fc 09 e0
		4b 20 80 01 84 42 04 d3 ff f7 ea fc ff f7 b2 fc
		10 bd 64 1c ff f7 24 fc 00 28 f1 d0 00 bf 00 bf
		00 bf 00 bf 00 bf 00 bf 00 bf 00 bf 00 bf 00 bf
		00 bf 00 bf 00 bf 00 bf 00 bf 00 bf 00 bf 00 bf
		00 bf 00 bf 00 bf ff f7 a5 fc 00 bf e0 e7 00 00
		10 b5 00 20 11 49 89 69 03 22 12 02 91 43 02 02
		03 23 1b 02 1a 40 11 43 0c 4a 91 61 00 bf 02 21
		04 20 01 f0 41 fa 00 20 08 49 89 69 03 22 92 02
		91 43 82 02 03 23 9b 02 1a 40 11 43 03 4a 91 61
		00 bf 02 21 05 20 01 f0 2f fa 10 bd 00 00 01 40
		10 b5 fe 48 00 78 08 28 0b da 00 f0 c3 ff fc 49
		fa 4a 12 78 88 54 f9 48 00 78 40 1c f7 49 08 70
		10 bd f6 48 00 78 08 28 26 d1 09 20 f3 49 08 70
		01 f0 48 ff f2 48 00 78 01 28 1e d1 f0 48 40 78
		00 28 1a d1 ee 48 80 78 01 28 16 d1 ec 48 c0 78
		c0 00 eb 49 09 79 89 00 08 43 e9 49 49 79 49 00
		08 43 e7 49 89 79 08 43 e6 49 08 70 e6 48 00 78
		00 28 6d d1 e5 49 08 70 6a e0 e1 48 00 78 01 28
		1e d1 df 48 40 78 00 28 1a d1 dd 48 80 78 00 28
		16 d1 db 48 c0 78 c0 00 d9 49 09 79 89 00 08 43
		d7 49 49 79 49 00 08 43 d5 49 89 79 08 43 d5 49
		08 70 00 20 d4 49 08 70 02 20 d4 49 08 70 47 e0
		cf 48 40 78 01 28 1e d1 cd 48 80 78 00 28 1a d1
		cb 48 c0 78 01 28 16 d1 c9 48 00 79 c0 00 c8 49
		49 79 89 00 08 43 c6 49 89 79 49 00 08 43 c4 49
		c9 79 08 43 c3 49 08 70 c3 48 00 78 00 28 01 d1
		c2 49 08 70 8c e7 be 48 40 78 01 28 1e d1 bc 48
		80 78 00 28 1a d1 ba 48 c0 78 00 28 16 d1 b8 48
		00 79 c0 00 b6 49 49 79 89 00 08 43 b4 49 89 79
		49 00 08 43 b2 49 c9 79 08 43 b2 49 08 70 00 20
		b1 49 08 70 02 20 b1 49 08 70 69 e7 01 f0 78 ff
		af 48 00 78 00 28 14 d1 ae 49 c8 70 08 71 48 71
		88 71 c8 71 08 72 48 72 ab 48 00 78 02 28 09 d1
		a4 48 00 78 00 07 00 0e a8 49 08 70 01 20 a5 49
		48 71 00 e2 a4 48 00 78 01 28 0a d1 a3 48 00 78
		9c 49 09 78 08 43 a1 49 08 70 01 20 9d 49 48 71
		f1 e1 9f 48 00 78 05 28 16 d1 9a 48 80 7a 99 49
		c8 70 08 46 c0 7a 08 71 08 46 00 7b 48 71 08 46
		40 7b 88 71 08 46 80 7b c8 71 08 46 c0 7b 08 72
		08 46 00 7c 48 72 d6 e1 91 48 00 78 04 28 09 d1
		88 48 00 78 00 07 00 0c 8e 49 08 80 01 20 89 49
		48 71 c8 e1 8a 48 00 78 03 28 0b d1 81 48 00 78
		00 02 88 49 09 88 08 43 86 49 08 80 01 20 81 49
		48 71 b8 e1 82 48 00 78 02 28 0b d1 79 48 00 78
		00 01 80 49 09 88 08 43 7e 49 08 80 01 20 79 49
		48 71 a8 e1 7a 48 00 78 01 28 15 d1 79 48 00 88
		70 49 09 78 08 43 77 49 08 80 00 f0 2d fb 01 20
		70 49 48 71 74 48 00 88 72 49 09 88 88 42 90 d1
		01 20 72 49 08 70 8e e1 71 48 00 78 00 28 4c d0
		6f 48 00 78 40 1e c1 00 08 1a 6e 49 09 68 08 5c
		64 49 c8 70 6a 48 00 78 40 1e c1 00 08 1a 69 49
		09 68 40 18 40 78 5f 49 08 71 65 48 00 78 40 1e
		c1 00 08 1a 63 49 09 68 40 18 80 78 59 49 48 71
		5f 48 00 78 40 1e c1 00 08 1a 5e 49 09 68 40 18
		c0 78 54 49 88 71 5a 48 00 78 40 1e c1 00 08 1a
		58 49 09 68 40 18 00 79 4e 49 c8 71 54 48 00 78
		40 1e c1 00 08 1a 53 49 09 68 40 18 40 79 49 49
		08 72 4f 48 00 78 40 1e c1 00 08 1a 4d 49 09 68
		40 18 80 79 43 49 48 72 3d e1 3e 48 00 78 09 28
		0c d1 00 20 40 49 08 70 41 49 08 70 44 49 08 70
		00 f0 f4 fd 01 20 44 49 08 70 79 e6 00 20 3a 49
		08 70 3b 49 08 70 3e 49 08 70 32 48 00 78 03 00
		ff f7 a4 fb 0e 08 0b 86 a0 d3 e6 22 22 22 22 22
		22 f0 ee 22 01 f0 74 fe 62 e6 38 48 00 78 00 28
		13 d0 37 48 00 78 00 28 06 d1 01 20 29 49 c8 70
		08 71 08 72 48 72 02 e0 01 20 26 49 88 71 30 48
		00 78 c0 43 2e 49 08 70 fc e0 2e 48 00 78 00 28
		0e d0 01 20 1f 49 c8 70 08 71 48 71 88 71 c8 71
		08 72 48 72 27 48 00 78 40 1e 26 49 08 70 e9 e0
		25 48 00 68 25 49 88 42 01 da 00 24 07 e0 22 49
		09 68 22 4a 88 1a 0a 21 ff f7 a0 f9 04 46 60 06
		c0 0f 10 49 c8 70 a0 06 c0 0f 08 71 e0 06 c0 0f
		48 71 20 07 c0 0f 88 71 60 07 c0 0f c8 71 a0 07
		c0 0f 08 72 e0 07 c0 0f 48 72 c3 e0 48 00 00 20
		40 00 00 20 4a 00 00 20 88 00 00 20 87 00 00 20
		49 00 00 20 00 01 00 20 4c 00 00 20 4d 00 00 20
		4f 00 00 20 52 00 00 20 54 00 00 20 56 00 00 20
		50 00 00 20 2c 00 00 20 3f 00 00 20 5d 00 00 20
		86 00 00 20 80 00 00 20 38 00 00 20 4c 0d 00 00
		00 21 08 46 01 f0 d2 ff 78 49 08 70 08 46 00 78
		02 28 03 d1 01 20 76 49 08 71 0a e0 73 48 00 78
		01 28 03 d1 72 49 08 71 48 71 02 e0 01 20 70 49
		48 71 7f e0 6f 48 00 78 40 06 c0 0f 6c 49 c8 70
		6c 48 00 78 80 06 c0 0f 08 71 6a 48 00 78 c0 06
		c0 0f 48 71 67 48 00 78 00 07 c0 0f 88 71 65 48
		00 78 40 07 c0 0f c8 71 62 48 00 78 80 07 c0 0f
		08 72 60 48 00 78 c0 07 c0 0f 48 72 00 20 5e 49
		08 70 5c 48 00 78 64 21 48 43 ff 30 2d 30 5b 49
		08 80 0a 20 5a 49 08 70 4c e0 5a 48 00 78 00 28
		07 d0 00 20 58 49 08 70 56 48 00 78 40 1e 55 49
		08 70 55 48 00 78 4e 49 c8 70 01 20 48 71 39 e0
		03 20 52 49 08 70 01 20 49 49 08 71 88 71 31 e0
		18 e0 ff e7 4e 48 00 78 00 28 03 d0 4d 48 00 78
		00 28 00 d1 26 e0 4a 48 00 78 40 1e 48 49 08 70
		06 20 49 49 08 70 00 f0 44 fd 48 49 08 70 00 f0
		51 f9 17 e0 46 48 00 78 40 1c 46 49 08 70 44 48
		00 78 80 1c 44 49 08 70 44 48 00 78 34 49 c8 70
		43 48 00 78 08 71 43 48 00 78 48 71 42 48 00 78
		88 71 00 bf 00 bf 2e 49 40 4a 12 78 88 5c 01 f0
		a3 fc 3e 48 00 78 40 1c 3c 49 08 70 08 46 00 78
		09 28 49 dd 04 20 00 f0 6b fa 01 f0 85 fc 00 20
		36 49 08 70 36 49 08 70 36 49 08 70 27 48 00 78
		00 28 05 d0 25 48 00 78 40 1e 24 49 08 70 33 e0
		25 48 00 78 00 28 05 d0 23 48 00 78 40 1e 22 49
		08 70 29 e0 23 48 00 78 00 28 0a d0 21 48 00 78
		40 1e 20 49 08 70 20 48 00 78 40 1e 1e 49 08 70
		1a e0 25 48 00 78 02 28 02 d0 04 28 13 d1 0a e0
		0a 48 00 78 01 28 05 d1 20 48 00 78 01 28 01 d1
		00 f0 74 fc 07 e0 01 20 0e 49 08 70 00 f0 d1 fc
		1b 49 08 70 00 bf 00 bf 00 bf f1 e4 94 00 00 20
		00 01 00 20 81 00 00 20 80 00 00 20 8a 00 00 20
		8c 00 00 20 88 00 00 20 3e 00 00 20 4c 00 00 20
		4e 00 00 20 5a 00 00 20 4f 00 00 20 5c 00 00 20
		30 00 00 20 50 00 00 20 51 00 00 20 32 00 00 20
		33 00 00 20 34 00 00 20 35 00 00 20 49 00 00 20
		48 00 00 20 4b 00 00 20 4a 00 00 20 57 00 00 20
		5b 00 00 20 10 b5 4c 48 00 78 08 28 0b da 00 f0
		71 fc 4a 49 48 4a 12 78 88 54 47 48 00 78 40 1c
		45 49 08 70 10 bd 44 48 00 78 08 28 40 d1 09 20
		41 49 08 70 01 f0 f6 fb 40 48 00 78 01 28 18 d1
		3e 48 40 78 00 28 14 d1 3c 48 80 78 01 28 10 d1
		3a 48 c0 78 c0 00 39 49 09 79 89 00 08 43 37 49
		49 79 49 00 08 43 35 49 89 79 08 43 34 49 08 70
		1e e0 32 48 40 78 01 28 18 d1 30 48 80 78 00 28
		14 d1 2e 48 c0 78 01 28 10 d1 2c 48 00 79 c0 00
		2a 49 49 79 89 00 08 43 28 49 89 79 49 00 08 43
		26 49 c9 79 08 43 26 49 08 70 bb e7 01 f0 78 fc
		24 48 00 78 00 28 21 d1 01 20 23 49 88 70 00 20
		c8 70 08 71 48 71 88 71 c8 71 08 72 48 72 1c 48
		00 78 04 28 02 d0 06 28 0c d1 07 e0 1b 48 00 78
		19 49 c8 70 01 20 c8 71 48 72 06 e0 01 20 16 49
		c8 70 02 e0 01 f0 54 fc 00 bf 00 bf 12 49 11 4a
		12 78 88 5c 01 f0 98 fb 0e 48 00 78 40 1c 0d 49
		08 70 08 46 00 78 09 28 0b dd 04 20 00 f0 60 f9
		01 f0 7a fb 00 20 07 49 08 70 03 49 08 70 08 49
		08 70 00 bf 76 e7 00 00 48 00 00 20 40 00 00 20
		4a 00 00 20 49 00 00 20 00 01 00 20 3e 00 00 20
		4b 00 00 20 28 48 00 78 40 02 28 49 09 78 49 00
		08 43 27 49 08 80 24 48 00 78 40 06 c0 0f 25 49
		48 71 21 48 00 78 80 06 c0 0f c8 72 1e 48 00 78
		c0 06 c0 0f 08 72 1c 48 00 78 00 07 c0 0f 08 74
		19 48 00 78 40 07 c0 0f 88 73 17 48 00 78 80 07
		c0 0f 48 73 14 48 00 78 c0 07 c0 0f c8 71 13 48
		00 78 40 06 c0 0f c8 70 10 48 00 78 80 06 c0 0f
		08 73 0e 48 00 78 c0 06 c0 0f 08 71 0b 48 00 78
		00 07 c0 0f 88 72 09 48 00 78 40 07 c0 0f 48 72
		06 48 00 78 80 07 c0 0f c8 73 04 48 00 78 c0 07
		c0 0f 88 71 70 47 00 00 5b 00 00 20 5c 00 00 20
		54 00 00 20 00 01 00 20 03 48 00 88 03 49 08 40
		01 49 08 80 70 47 00 00 52 00 00 20 fe fe 00 00
		10 b5 04 46 01 f0 68 fa 20 46 01 f0 8b fa 80 b2
		10 bd 70 47 70 47 00 00 38 b5 04 46 6a 46 02 21
		20 46 fe f7 b3 ff 69 46 48 78 00 02 09 78 08 43
		05 46 06 2c 01 d1 02 48 2d 18 28 46 38 bd 00 00
		55 f5 ff ff 7c b5 11 a0 00 68 01 90 01 aa 02 21
		3e 20 fe f7 a7 ff 00 f0 a5 f8 6a 46 04 21 40 20
		fe f7 94 ff 68 46 40 78 01 02 68 46 00 78 01 43
		0c 46 68 46 c0 78 00 02 69 46 89 78 08 43 05 46
		ac 42 01 da 28 46 7c bd 20 46 fc e7 71 00 00 00
		10 b5 01 20 ff f7 b4 ff 6c 28 09 db 02 20 ff f7
		af ff 6c 28 04 db 03 20 ff f7 aa ff 6c 28 05 da
		08 48 00 78 40 1c 07 49 08 70 02 e0 00 20 05 49
		08 70 04 48 00 78 09 28 01 dd 01 20 10 bd 00 20
		fc e7 00 00 85 00 00 20 10 b5 04 46 00 2c 02 d0
		00 20 01 f0 71 f8 05 4a 03 21 04 20 00 f0 da fc
		00 2c 02 d0 01 20 01 f0 67 f8 10 bd 31 02 00 00
		10 b5 04 46 00 2c 02 d0 00 20 01 f0 5d f8 05 4a
		03 21 0a 20 00 f0 c6 fc 00 2c 02 d0 01 20 01 f0
		53 f8 10 bd 31 02 00 00 08 b5 08 e0 64 21 00 91
		00 e0 00 bf 00 99 4a 1e 00 92 00 29 f9 d1 01 46
		40 1e 00 29 f2 d1 08 bd 08 b5 08 e0 06 49 00 91
		00 e0 00 bf 00 99 4a 1e 00 92 00 29 f9 d1 01 46
		40 1e 00 29 f2 d1 08 bd c9 29 00 00 08 b5 06 20
		00 90 00 e0 00 bf 00 98 41 1e 00 91 00 28 f9 d1
		08 bd 10 b5 02 20 ff f7 df ff 10 bd 08 b5 2c 20
		00 90 00 e0 00 bf 00 98 41 1e 00 91 00 28 f9 d1
		08 bd 00 00 08 b5 05 48 00 90 00 e0 00 bf 00 98
		41 1e 00 91 00 28 f9 d1 08 bd 00 00 37 02 00 00
		10 b5 02 46 14 46 03 e0 ff f7 ec ff 60 1e c4 b2
		00 2c f9 dc 10 bd 70 47 86 b0 00 26 00 27 00 20
		05 90 04 90 03 90 02 90 e1 20 40 01 f9 49 08 80
		f9 48 fa 49 08 80 fa 48 fa 49 08 60 fa 49 08 60
		0a 20 fa 49 08 70 e3 e1 01 f0 ea fc f8 48 00 68
		00 28 3d d1 58 20 01 f0 f3 fa 04 46 f5 48 00 78
		00 28 30 d1 1f 2c 05 d1 00 f0 10 fa 01 20 f1 49
		08 70 1b e0 00 2c 02 d1 01 f0 86 fa 16 e0 0c 2c
		02 d1 3f 20 01 90 11 e0 01 2c 07 db 0b 2c 05 dc
		60 1c 81 00 40 18 c0 b2 01 90 07 e0 0d 2c 05 db
		19 2c 03 dc a0 00 20 18 c0 b2 01 90 e2 48 00 78
		00 28 08 d1 e1 48 02 78 e1 48 00 78 01 99 01 f0
		f7 f9 dd 49 08 70 7d 20 00 01 d9 49 08 60 9c e1
		d4 48 00 68 00 28 79 d1 0c 20 ff f7 bd fe 05 46
		00 bf d4 48 00 78 00 28 6b d1 d6 48 85 42 07 da
		78 1c c7 b2 03 2f 04 dd 54 20 01 f0 0d fa 00 e0
		00 27 d1 48 85 42 0a dd 04 98 40 1c c0 b2 04 90
		04 98 07 28 05 dd 59 20 01 f0 fe f9 01 e0 00 20
		04 90 ff 20 f5 30 85 42 04 da c8 48 00 68 c8 49
		88 42 09 dc 19 20 40 01 85 42 10 da c3 48 00 68
		c3 49 14 31 88 42 0a dd 03 98 40 1c c0 b2 03 90
		03 98 05 28 05 dd 5a 20 01 f0 de f9 01 e0 00 20
		03 90 bc 48 00 88 85 42 11 dd ba 48 00 88 ba 49
		88 42 0c dd b9 48 00 78 00 28 05 d0 b7 48 00 78
		40 1e b6 49 08 70 02 e0 55 20 01 f0 c5 f9 af 48
		00 68 af 49 09 1d 88 42 10 dd b1 48 85 42 0d dd
		a2 48 00 78 40 1e a1 49 08 70 08 46 00 78 00 28
		07 d1 55 20 01 f0 b0 f9 03 e0 07 e0 0a 20 9b 49
		08 70 7d 20 c0 00 97 49 08 60 1e e1 a5 48 00 68
		00 28 7d d1 ff f7 56 fe 9c 49 08 60 95 48 00 78
		00 28 76 d1 8d 48 00 88 00 28 07 d1 94 48 00 78
		3f 28 1c dd 3f 20 92 49 08 70 18 e0 87 48 00 88
		0a 28 07 da 8e 48 00 78 32 28 10 dd 32 20 8c 49
		08 70 0c e0 81 48 00 88 ff 21 37 31 88 42 06 da
		87 48 00 78 37 28 02 dd 37 20 85 49 08 70 8e 48
		00 78 00 28 19 d1 85 48 00 68 85 49 88 42 07 dd
		7f 48 00 78 3f 28 10 dd 3f 20 7d 49 08 70 0c e0
		7e 48 00 68 7e 49 fa 39 88 42 06 dd 78 48 00 78
		3f 28 02 dd 3f 20 76 49 08 70 78 48 00 68 78 49
		96 39 88 42 07 dd 72 48 00 78 3f 28 1e dd 3f 20
		6f 49 08 70 1a e0 71 48 00 68 21 21 c9 01 88 42
		07 dd 6b 48 00 78 3f 28 10 dd 3f 20 68 49 08 70
		0c e0 6a 48 00 68 6a 49 e6 39 88 42 06 dd 64 48
		00 78 3f 28 02 dd 3f 20 61 49 08 70 5e 48 00 78
		00 28 0c d1 5d 48 02 78 68 48 01 78 5c 48 01 e0
		2f e0 27 e0 00 78 01 f0 eb f8 57 49 08 70 64 48
		00 78 02 28 08 d1 59 48 00 68 59 49 10 39 88 42
		02 dd 5a 20 01 f0 10 f9 54 48 00 68 54 49 32 31
		88 42 02 dd 5a 20 01 f0 07 f9 50 48 00 68 50 49
		28 31 88 42 07 dd 70 1c c6 b2 05 2e 04 dd 5a 20
		01 f0 fa f8 00 e0 00 26 ff 20 f5 30 4d 49 08 60
		6b e0 3d 48 00 68 00 28 1f d1 06 20 ff f7 8c fd
		05 46 3c 48 00 78 00 28 12 d1 00 2d 03 dd ff 20
		f5 30 85 42 0a dd 05 98 40 1c c0 b2 05 90 05 98
		02 28 05 dd 5c 20 01 f0 d7 f8 01 e0 00 20 05 90
		ff 20 f5 30 2c 49 08 60 47 e0 3e 48 00 68 00 28
		1e d1 2c 48 00 78 00 28 0e d1 ff f7 a1 fd 00 28
		05 d0 00 20 00 f0 7a f8 01 20 26 49 08 70 19 20
		40 01 34 49 08 60 30 e0 02 98 00 28 04 d1 5d 20
		01 f0 46 f9 01 20 02 90 2f 48 2e 49 08 60 24 e0
		2e 48 00 78 00 28 20 d1 12 48 00 88 00 28 06 d1
		18 48 00 78 00 28 02 d1 5a 20 01 f0 9d f8 28 48
		00 78 00 28 03 d0 59 20 01 f0 96 f8 0a e0 25 48
		00 78 00 28 03 d1 24 48 00 78 01 28 02 dd 54 20
		01 f0 8a f8 14 20 1d 49 08 70 2f 20 ff f7 f8 fd
		1a e6 00 00 62 00 00 20 26 02 00 00 64 00 00 20
		20 4e 00 00 6c 00 00 20 78 00 00 20 8d 00 00 20
		70 00 00 20 5d 00 00 20 80 00 00 20 59 00 00 20
		82 00 00 20 30 f8 ff ff 4c 1d 00 00 38 00 00 20
		62 11 00 00 8a 00 00 20 fc 08 00 00 8c 00 00 20
		1c 0c 00 00 68 00 00 20 83 00 00 20 58 00 00 20
		8e 00 00 20 7c 00 00 20 10 27 00 00 74 00 00 20
		3f 00 00 20 3c 00 00 20 89 00 00 20 00 28 08 d0
		08 49 c9 69 01 22 12 04 91 43 89 18 05 4a d1 61
		06 e0 04 49 c9 69 01 22 12 04 91 43 01 4a d1 61
		70 47 00 00 00 00 02 40 03 48 c0 69 01 21 09 04
		88 43 01 49 c8 61 70 47 00 00 02 40 01 46 00 29
		08 d0 01 29 15 d1 0c 48 00 68 42 07 52 0f 0b 48
		d0 40 70 47 08 48 00 68 80 06 40 0f 00 28 01 d1
		07 48 f6 e7 04 48 00 68 80 06 42 0f 03 48 d0 40
		ef e7 02 48 ed e7 00 00 00 00 02 40 00 24 f4 00
		00 12 7a 00 10 b5 05 20 00 f0 98 f8 00 28 01 d0
		01 20 10 bd 00 20 fc e7 10 b5 09 20 00 f0 8e f8
		00 28 01 d0 01 20 10 bd 00 20 fc e7 03 48 c0 69
		c0 03 c0 0f 01 21 48 40 70 47 00 00 00 00 02 40
		70 47 10 b5 01 20 80 07 00 f0 a8 fa c4 b2 64 06
		64 0e 20 46 10 bd 00 00 04 49 89 69 89 08 89 00
		82 07 92 0f 11 43 01 4a 91 61 70 47 00 00 01 40
		05 49 89 69 0c 22 91 43 82 00 0c 23 1a 40 11 43
		01 4a 91 61 70 47 00 00 00 00 01 40 70 b5 0b 48
		85 6b 00 24 0e e0 01 20 a0 40 28 40 00 28 08 d0
		a0 00 07 49 08 58 00 28 03 d0 a1 00 04 4a 50 58
		80 47 64 1c 10 2c ee d3 70 bd 00 00 00 00 01 40
		ac 00 00 20 10 28 04 da 01 21 81 40 03 4a 91 63
		03 e0 00 21 c9 43 01 4a 91 63 70 47 00 00 01 40
		10 b5 02 46 10 2a 01 da 10 48 00 e0 10 bd 00 bf
		72 b6 00 bf 00 29 0a d1 03 69 01 24 94 40 a3 43
		03 61 83 68 01 24 94 40 23 43 83 60 09 e0 83 68
		01 24 94 40 23 43 83 60 03 69 01 24 94 40 23 43
		03 61 00 bf 62 b6 00 bf 00 bf df e7 00 00 01 40
		01 48 80 6b 70 47 00 00 00 00 01 40 10 b5 01 46
		10 29 01 da 0a 4a 01 e0 00 20 10 bd 00 bf 72 b6
		00 bf 10 68 01 24 8c 40 20 40 00 28 01 d0 01 20
		00 e0 00 20 03 46 00 bf 62 b6 00 bf 18 46 ec e7
		00 00 01 40 ff b5 81 b0 04 46 15 46 1e 46 11 48
		04 70 01 20 0f 49 48 70 89 1c 02 a8 fe f7 26 fb
		0c 48 85 71 c1 1d 30 46 fe f7 20 fb 09 48 c0 1d
		fe f7 12 fb 00 90 07 48 81 79 00 98 fe f7 01 fb
		04 48 00 f0 4f f8 07 46 00 f0 9d f8 38 46 05 b0
		f0 bd 00 00 11 01 00 20 10 b5 00 bf 1f 48 00 68
		40 08 40 00 1d 49 08 60 08 46 00 68 04 21 88 43
		1a 49 08 60 00 bf 00 20 19 49 89 69 03 22 92 05
		91 43 82 05 03 23 9b 05 1a 40 11 43 14 4a 91 61
		00 bf 00 bf 11 46 89 69 9a 00 91 43 02 06 9b 00
		1a 40 11 43 0e 4a 91 61 00 bf 02 21 0c 20 00 f0
		53 f9 02 21 0b 20 00 f0 4f f9 00 21 0c 20 00 f0
		81 f9 00 21 0b 20 00 f0 7d f9 00 21 0c 20 ff f7
		4f ff 00 21 0b 20 ff f7 4b ff 10 bd 00 c0 00 40
		00 00 01 40 70 b5 04 46 fe f7 96 fe 21 78 49 06
		08 0e fe f7 0b fe 01 28 03 d1 fe f7 9e fe 01 20
		70 bd 00 25 0d e0 a0 1c fe f7 a6 fa 46 5d 30 46
		fe f7 fc fd 01 28 03 d1 fe f7 8f fe 01 20 ef e7
		6d 1c 60 78 a8 42 ee d8 fe f7 4e fe 21 78 49 00
		49 1c c8 b2 fe f7 ea fd 01 28 03 d1 fe f7 7d fe
		01 20 dd e7 00 25 17 e0 e0 1d fe f7 85 fa 06 46
		a0 79 40 1e a8 42 01 d1 01 20 00 e0 00 20 01 46
		30 46 fe f7 5d fd e0 1d fe f7 76 fa 46 1c e1 1d
		30 46 fe f7 7b fa 6d 1c a0 79 a8 42 e4 d8 fe f7
		5c fe 00 20 bc e7 10 b5 02 20 ff f7 ad fb fe f7
		43 fe ff f7 cb fb fe f7 1d fb 00 24 05 e0 4b 20
		80 01 84 42 00 d3 04 e0 64 1c fe f7 89 fa 00 28
		f5 d0 00 bf fe f7 1e fb 10 bd 70 b5 05 46 fe f7
		2b fe 29 78 49 06 08 0e fe f7 a0 fd 01 28 03 d1
		fe f7 33 fe 01 20 70 bd 00 24 0d e0 a8 1c fe f7
		3b fa 06 5d 30 46 fe f7 91 fd 01 28 03 d1 fe f7
		24 fe 01 20 ef e7 64 1c 68 78 a0 42 ee d8 00 24
		0d e0 e8 1d fe f7 28 fa 06 5d 30 46 fe f7 7e fd
		01 28 03 d1 fe f7 11 fe 01 20 dc e7 64 1c a8 79
		a0 42 ee d8 fe f7 09 fe 00 20 d4 e7 37 b5 04 46
		0b 48 04 70 01 20 0a 49 48 70 89 1c 01 a8 fe f7
		15 fa 02 20 06 49 88 71 c9 1d 02 a8 fe f7 0e fa
		03 48 ff f7 b2 ff 05 46 ff f7 95 ff 28 46 3e bd
		11 01 00 20 f8 b5 05 46 0e 46 17 46 10 2d 01 da
		36 4c 00 e0 f8 bd 00 21 28 46 ff f7 79 fe 00 2e
		06 d0 01 2e 0f d0 02 2e 18 d0 03 2e 2c d1 20 e0
		a0 6a 01 21 a9 40 88 43 a0 62 20 6b 01 21 a9 40
		88 43 20 63 21 e0 a0 6a 01 21 a9 40 08 43 a0 62
		20 6b 01 21 a9 40 88 43 20 63 16 e0 a0 6a 01 21
		a9 40 88 43 a0 62 20 6b 01 21 a9 40 08 43 20 63
		0b e0 a0 6a 01 21 a9 40 08 43 a0 62 20 6b 01 21
		a9 40 08 43 20 63 00 e0 c4 e7 00 bf a8 00 18 49
		0f 50 e1 6b 01 20 a8 40 81 43 e1 63 20 6a 01 21
		a9 40 08 43 20 62 11 20 00 28 0c db 11 49 09 68
		c3 06 db 0e 01 22 9a 40 11 40 00 29 01 d0 01 21
		02 e0 00 21 00 e0 00 21 00 29 0d d1 11 20 00 28
		05 db c2 06 d2 0e 01 21 91 40 06 4a 11 60 00 bf
		00 21 11 20 fe f7 3c fb 00 bf 93 e7 00 00 01 40
		ac 00 00 20 00 e1 00 e0 10 b5 02 46 10 2a 01 da
		17 48 00 e0 10 bd 00 29 04 d0 01 29 0d d0 02 29
		21 d1 15 e0 43 6c 01 24 94 40 23 43 43 64 83 6c
		01 24 94 40 a3 43 83 64 16 e0 43 6c 01 24 94 40
		a3 43 43 64 83 6c 01 24 94 40 23 43 83 64 0b e0
		43 6c 01 24 94 40 a3 43 43 64 83 6c 01 24 94 40
		a3 43 83 64 00 e0 00 bf 00 bf 00 bf d2 e7 00 00
		00 00 01 40 10 b5 02 46 10 2a 01 da 0b 48 00 e0
		10 bd 00 bf 72 b6 00 bf 01 29 05 d1 43 68 01 24
		94 40 23 43 43 60 04 e0 44 68 01 23 93 40 9c 43
		44 60 00 bf 62 b6 00 bf 00 bf e9 e7 00 00 01 40
		10 b5 01 20 81 07 c8 60 01 48 00 68 80 47 10 bd
		04 00 00 20 10 b5 01 20 02 49 c8 60 02 48 00 68
		80 47 10 bd 00 10 00 40 08 00 00 20 01 46 48 68
		70 47 01 46 08 68 c0 07 c0 0f 70 47 f8 b5 04 46
		0e 46 15 46 01 20 ff f7 01 fd 7d 21 c9 00 00 90
		fe f7 c6 f8 70 43 07 46 a7 60 67 60 00 20 c0 43
		e0 60 20 68 08 21 88 43 08 30 20 60 c8 06 84 42
		09 d1 0a 48 05 60 02 21 08 20 fe f7 dd fa 08 20
		fe f7 92 fa 08 e0 06 48 05 60 02 21 09 20 fe f7
		d3 fa 09 20 fe f7 88 fa f8 bd 00 00 04 00 00 20
		08 00 00 20 01 68 49 08 49 00 49 1c 01 60 70 47
		10 b5 ff f7 d1 fd 10 bd 0d 48 41 68 0d 4b c9 01
		0e d5 41 68 c9 03 0b d4 00 21 c9 43 41 60 41 6f
		82 15 91 43 41 67 08 4a 00 21 51 70 d1 60 19 70
		19 78 04 4a 89 00 08 32 52 58 02 49 10 47 00 00
		00 c0 00 40 0c 00 00 20 ec 00 00 20 01 21 0d 4a
		0b 48 89 04 11 60 bf f3 4f 8f bf f3 6f 8f 51 17
		41 60 41 6f 82 15 91 43 41 67 00 21 81 60 01 68
		49 08 49 00 01 60 01 68 04 22 91 43 01 60 70 47
		00 c0 00 40 80 e1 00 e0 06 48 07 49 41 60 07 49
		01 60 81 68 3f 22 12 02 11 40 09 0a 04 4a 11 61
		70 47 00 00 00 30 00 40 02 00 00 80 01 4f 4c 46
		00 e0 00 40 ff f7 e8 ff 00 f0 28 fa fe f7 a0 fc
		00 f0 32 fe 00 f0 23 fa ff f7 9a ff 00 20 ff f7
		9f f9 01 20 00 f0 00 fa 53 20 00 f0 a1 fd 05 46
		2d 07 2d 0f 00 2d 01 d1 0a 24 11 e0 01 2d 01 d1
		3c 24 0d e0 02 2d 01 d1 82 24 09 e0 03 2d 01 d1
		aa 24 05 e0 04 2d 02 d1 ff 24 05 34 00 e0 0a 24
		32 2c 0b db 78 2c 09 da d4 48 d5 49 08 60 04 20
		d4 49 08 70 02 20 d4 49 08 70 2f e0 78 2c 08 db
		a0 2c 06 da d1 48 ce 49 08 60 04 20 cd 49 08 70
		24 e0 a0 2c 0a db ff 20 5f 30 84 42 06 da cc 48
		c7 49 08 60 06 20 c7 49 08 70 17 e0 ff 20 5f 30
		84 42 0a db ff 20 af 30 84 42 06 da c5 48 c0 49
		08 60 06 20 bf 49 08 70 08 e0 c3 48 bc 49 08 60
		04 20 bc 49 08 70 02 20 bb 49 08 70 b9 49 08 78
		c1 0f 09 18 49 10 bd 4a 11 70 10 46 00 78 08 21
		08 40 c0 10 ba 49 08 70 10 46 00 78 04 21 08 40
		80 10 b8 49 08 70 10 46 00 78 02 21 08 40 40 10
		b5 49 08 70 10 46 00 78 c0 07 c0 0f b3 49 08 70
		00 f0 70 fc 00 f0 86 fc 00 f0 96 fb 00 f0 6c fb
		00 20 ff f7 01 f9 00 bf ff f7 7d f9 00 f0 8a fc
		00 28 f9 d0 00 f0 77 fe 15 e0 00 f0 79 fe a8 48
		00 78 00 28 01 d0 00 f0 27 fc a6 48 00 78 01 28
		04 d1 a5 48 00 78 01 28 00 d1 05 e0 a3 48 00 78
		00 28 00 d1 00 e0 e8 e7 00 bf 01 20 a0 49 08 70
		ff f7 77 f8 52 20 00 f0 6b fc 05 46 01 20 9d 49
		08 70 00 2d 01 d1 00 f0 07 fc 00 f0 51 fe 5e 20
		00 f0 5e fc 05 46 02 2d 01 d0 00 f0 fd fb 00 f0
		47 fe ff f7 16 f9 00 f0 43 fe 93 48 00 78 00 f0
		4f fc 05 46 02 2d 01 d0 00 f0 ee fb 00 f0 38 fe
		00 f0 36 fe 8c 48 00 78 00 28 03 d0 ff f7 62 f8
		8a 49 08 60 ff f7 fd f8 87 48 00 78 00 28 03 d0
		2c 20 ff f7 41 f8 c6 b2 55 2e 27 dd ff 20 5f 30
		84 42 05 db 14 20 82 49 08 70 82 49 08 70 8e e0
		a0 2c 05 db 14 20 7e 49 08 70 7e 49 08 70 86 e0
		78 2c 05 db 14 20 7a 49 08 70 7a 49 08 70 7e e0
		32 2c 05 db 0f 20 76 49 08 70 76 49 08 70 76 e0
		0f 20 73 49 08 70 73 49 08 70 70 e0 4b 2e 27 dd
		ff 20 5f 30 84 42 05 db 1e 20 6d 49 08 70 6d 49
		08 70 64 e0 a0 2c 05 db 1e 20 69 49 08 70 69 49
		08 70 5c e0 78 2c 05 db 1e 20 65 49 08 70 65 49
		08 70 54 e0 32 2c 05 db 19 20 61 49 08 70 61 49
		08 70 4c e0 0f 20 5e 49 08 70 5e 49 08 70 46 e0
		32 2e 27 dd ff 20 5f 30 84 42 05 db 2d 20 58 49
		08 70 58 49 08 70 3a e0 a0 2c 05 db 28 20 54 49
		08 70 54 49 08 70 32 e0 78 2c 05 db 28 20 50 49
		08 70 50 49 08 70 2a e0 32 2c 05 db 19 20 4c 49
		08 70 4c 49 08 70 22 e0 15 20 49 49 08 70 49 49
		08 70 1c e0 a0 2c 05 db 3f 20 45 49 08 70 45 49
		08 70 14 e0 78 2c 05 db 28 20 41 49 08 70 41 49
		08 70 0c e0 32 2c 05 db 19 20 3d 49 08 70 3d 49
		08 70 04 e0 15 20 3a 49 08 70 3a 49 08 70 ff f7
		58 f8 ff f7 1d fb 58 20 00 f0 92 fb 01 20 36 49
		08 70 2e 48 00 78 00 28 24 d1 22 e0 00 f0 78 fd
		32 48 00 68 00 28 0a d1 58 20 00 f0 81 fb 00 28
		01 d1 00 f0 21 fb 2e 48 2c 49 08 60 11 e0 2d 48
		00 78 00 28 0d d1 1e 48 00 78 00 28 03 d1 21 48
		00 78 01 28 02 dd 54 20 00 f0 d6 fa 14 20 25 49
		08 70 db e7 0c e0 00 f0 53 fd 15 48 00 78 00 28
		03 d1 18 48 00 78 01 28 02 dd 54 20 00 f0 c4 fa
		ff f7 d4 fa 01 28 ee d0 ff f7 3e f8 38 2f 00 00
		2c 00 00 20 30 00 00 20 8e 00 00 20 54 2f 00 00
		70 2f 00 00 9a 2f 00 00 1c 2f 00 00 31 00 00 20
		32 00 00 20 33 00 00 20 34 00 00 20 35 00 00 20
		3c 00 00 20 56 00 00 20 51 00 00 20 87 00 00 20
		57 00 00 20 89 00 00 20 4d 00 00 20 38 00 00 20
		81 00 00 20 82 00 00 20 3e 00 00 20 70 00 00 20
		70 17 00 00 74 00 00 20 00 28 09 d0 0a 49 09 78
		00 29 05 d1 00 bf 62 b6 00 bf 07 49 08 70 0a e0
		00 28 08 d1 04 49 09 78 00 29 04 d0 00 bf 72 b6
		00 bf 01 49 08 70 70 47 a4 00 00 20 70 47 10 b5
		ff f7 3a fa 00 f0 16 fa 00 f0 ec f9 00 f0 f4 f9
		00 f0 ca f9 fe f7 fe fe 10 bd 00 00 70 b5 06 46
		1c 4d 1d 4c 01 20 ff f7 7f fa 06 2e 0b d1 e0 69
		01 21 49 04 88 43 40 18 e0 61 e0 69 89 00 88 43
		40 18 e0 61 16 e0 69 68 09 01 89 0e 10 22 11 43
		89 05 3f 22 92 05 11 40 08 46 69 68 91 43 01 43
		69 60 e0 69 01 21 49 04 88 43 e0 61 e0 69 89 00
		88 43 e0 61 69 68 89 05 89 0e 10 22 11 43 09 01
		3f 22 12 01 11 40 08 46 69 68 91 43 01 43 69 60
		70 bd 00 00 00 70 00 40 00 00 02 40 70 b5 06 46
		17 4c 18 4d 01 20 ff f7 4b fa 07 2e 06 d1 e8 69
		01 21 89 04 88 43 40 18 e8 61 12 e0 61 68 09 01
		89 0e 20 22 11 43 89 05 3f 22 92 05 11 40 08 46
		61 68 91 43 01 43 61 60 e8 69 01 21 89 04 88 43
		e8 61 61 68 89 05 89 0e 20 22 11 43 09 01 3f 22
		12 01 11 40 08 46 61 68 91 43 01 43 61 60 70 bd
		00 70 00 40 00 00 02 40 70 b5 02 46 31 49 32 48
		13 00 fd f7 5b ff 08 05 06 07 08 09 0a 1a 34 4a
		00 bf 00 bf 00 bf 00 bf 00 bf 4c 68 a4 05 a4 0e
		01 25 95 40 ac 43 24 01 3f 25 2d 01 2c 40 23 46
		4c 68 ac 43 1c 43 4c 60 42 e0 4c 68 a4 05 a4 0e
		95 1e 01 26 ae 40 b4 43 24 01 3f 25 2d 01 2c 40
		23 46 4c 68 ac 43 1c 43 4c 60 c3 69 01 24 64 04
		a3 43 c3 61 c3 69 a4 00 a3 43 c3 61 28 e0 4c 68
		a4 05 a4 0e 95 1e 01 26 ae 40 b4 43 24 01 3f 25
		2d 01 2c 40 23 46 4c 68 ac 43 1c 43 4c 60 c3 69
		01 24 a4 04 a3 43 c3 61 12 e0 4b 68 3f 24 24 01
		a3 43 4b 60 c3 69 01 24 64 04 a3 43 c3 61 c3 69
		a4 00 a3 43 c3 61 c3 69 64 10 a3 43 c3 61 00 bf
		00 bf 70 bd 00 70 00 40 00 00 02 40 70 b5 05 46
		3c 4c 2b 00 fd f7 f2 fe 09 1a 2a 49 4a 69 6e 6a
		6f 06 73 00 60 68 3f 21 89 05 88 43 1f 21 c9 05
		40 18 60 60 60 68 3f 21 09 01 08 43 60 60 01 20
		ff f7 8a f9 01 20 ff f7 93 f9 59 e0 61 68 89 05
		89 0e 01 22 aa 40 11 43 09 01 3f 22 12 01 11 40
		08 46 61 68 91 43 01 43 61 60 49 e0 61 68 09 01
		89 0e 01 22 aa 40 11 43 89 05 3f 22 92 05 11 40
		08 46 61 68 91 43 01 43 61 60 61 68 89 05 89 0e
		01 22 aa 40 11 43 09 01 3f 22 12 01 11 40 08 46
		61 68 91 43 01 43 61 60 2a e0 00 bf 61 68 09 01
		89 0e 01 22 aa 40 11 43 89 05 3f 22 92 05 11 40
		08 46 61 68 91 43 01 43 61 60 61 68 89 05 89 0e
		01 22 aa 40 11 43 09 01 3f 22 12 01 11 40 08 46
		61 68 91 43 01 43 61 60 0a e0 00 bf 28 46 ff f7
		ad fe 05 e0 00 bf 28 46 ff f7 e8 fe 00 e0 00 bf
		00 bf 70 bd 00 70 00 40 07 48 08 49 09 78 01 29
		00 d1 70 47 01 21 05 4a 11 70 05 49 41 60 00 21
		c9 43 c1 60 00 bf f4 e7 00 70 00 40 00 00 00 20
		01 0c 00 00 06 49 ca 68 ca 60 40 23 13 40 00 2b
		04 d0 00 20 00 e0 40 1c 05 28 fc d9 70 47 00 00
		00 70 00 40 70 b5 04 46 1e 4d 08 2c 01 db 00 20
		70 bd 20 46 ff f7 52 ff 00 bf 1a 48 00 68 40 08
		40 00 40 1c 17 49 08 60 00 bf 64 23 00 22 04 21
		28 46 00 f0 27 fb 00 28 22 d0 20 46 ff f7 d4 fe
		06 2c 09 d1 a0 1e 81 00 28 46 10 30 40 58 86 05
		b6 0d 0a 20 46 43 11 e0 07 2c 09 d1 a0 1e 81 00
		28 46 10 30 40 58 86 05 b6 0d 06 20 46 43 05 e0
		a1 00 28 46 10 30 40 58 86 05 b6 0d 30 46 c7 e7
		00 20 c5 e7 00 70 00 40 10 b5 00 21 04 20 ff f7
		ff f8 10 bd 10 b5 00 21 04 20 ff f7 23 fb 01 21
		04 20 ff f7 f5 f8 10 bd 10 b5 04 46 00 2c 04 d0
		01 21 04 20 ff f7 16 fb 03 e0 00 21 04 20 ff f7
		11 fb 10 bd 10 b5 00 21 0a 20 ff f7 d5 fa 00 21
		0a 20 ff f7 dd f8 10 bd 10 b5 00 21 05 20 ff f7
		d7 f8 10 bd 10 b5 00 21 05 20 ff f7 fb fa 01 21
		05 20 ff f7 cd f8 10 bd 10 b5 04 46 00 2c 04 d0
		01 21 05 20 ff f7 ee fa 03 e0 00 21 05 20 ff f7
		e9 fa 10 bd 10 b5 00 21 09 20 ff f7 b9 f8 10 bd
		10 b5 00 21 09 20 ff f7 dd fa 01 21 09 20 ff f7
		af f8 10 bd 10 b5 04 46 00 2c 04 d0 01 21 09 20
		ff f7 d0 fa 03 e0 00 21 09 20 ff f7 cb fa 10 bd
		30 b5 03 46 10 48 04 78 10 48 00 78 98 42 01 dd
		0e 48 03 70 0e 48 01 70 0e 48 02 70 91 42 00 da
		0a 46 0a 48 00 78 90 42 02 dd 07 48 02 70 03 e0
		06 48 00 78 04 4d 28 70 03 48 00 78 84 42 01 d0
		05 20 30 bd 00 20 fc e7 81 00 00 20 82 00 00 20
		58 00 00 20 59 00 00 20 02 48 01 69 02 69 0a 43
		02 61 70 47 00 a0 00 40 10 b5 04 46 00 f0 80 fa
		00 20 fe f7 b3 ff ff f7 87 ff 20 46 00 f0 88 f8
		00 f0 2a f8 10 bd 00 00 70 b5 04 46 00 20 fe f7
		c5 ff 60 43 05 46 00 bf 0b 48 0c 49 08 60 00 bf
		0b 48 05 60 45 60 03 20 09 49 88 60 09 48 00 68
		40 21 88 43 40 30 07 49 08 60 00 bf 00 20 03 49
		08 60 00 bf 70 bd 00 00 51 e5 cc 1a 00 8c 00 40
		00 80 00 40 00 00 02 40 00 bf 00 bf 00 bf 00 bf
		00 bf bf f3 4f 8f 00 bf 00 bf 00 bf 06 48 07 49
		c8 60 00 bf 00 bf 00 bf bf f3 4f 8f 00 bf 00 bf
		00 bf 00 bf 00 bf fd e7 04 00 fa 05 00 ed 00 e0
		10 b5 07 48 00 78 02 28 09 d0 05 48 00 78 01 28
		03 d1 02 20 02 49 08 70 01 e0 ff f7 d5 ff 10 bd
		89 00 00 20 10 b5 00 24 ff f7 04 ff 00 bf 0d e0
		00 20 ff f7 09 ff 01 20 fe f7 02 fd 01 20 ff f7
		03 ff 03 20 fe f7 fc fc 60 1c c4 b2 1e 2c ef db
		10 bd 00 00 10 b5 03 4a 01 21 88 07 ff f7 4e fa
		10 bd 00 00 cd 03 00 00 10 b5 01 20 80 07 ff f7
		79 fa 10 bd 10 b5 01 20 80 07 ff f7 3a fa 10 bd
		fe b5 05 46 00 27 00 f0 eb f9 01 95 00 20 3e 49
		08 70 ff f7 15 ff fe f7 b9 fc 00 20 ff f7 1a ff
		fe f7 af fc 01 20 ff f7 15 ff 00 24 1f e0 37 48
		00 78 00 28 03 d0 58 2d 01 d1 ff f7 dd fe 00 f0
		cf f9 00 bf 30 48 00 78 00 28 fb d0 00 f0 c8 f9
		06 20 01 1b 01 98 08 41 c0 07 c0 0f 00 90 00 98
		ff f7 f8 fe 00 20 28 49 08 70 60 1c c4 b2 07 2c
		dd db 00 f0 b5 f9 00 24 28 e0 24 48 00 78 00 28
		03 d0 58 2d 01 d1 ff f7 b7 fe 00 f0 a9 f9 00 bf
		1d 48 00 78 00 28 fb d0 00 f0 a2 f9 00 2c 03 d1
		ff f7 c8 fe fe f7 72 fc 00 20 17 49 08 70 fe f7
		1b ff 06 46 06 2c 07 d0 00 2c 05 d0 05 20 01 1b
		30 46 88 40 38 43 c7 b2 60 1c c4 b2 07 2c d4 db
		00 f0 86 f9 00 bf 0c 48 00 78 00 28 fb d0 00 f0
		7f f9 ff f7 ad fe fe f7 51 fc 00 20 ff f7 b2 fe
		00 20 05 49 08 70 fe f7 44 fc fe f7 42 fc 00 f0
		6f f9 38 46 fe bd 00 00 3d 00 00 20 3c 00 00 20
		fe b5 05 46 00 27 00 f0 63 f9 01 95 00 20 3c 49
		08 70 ff f7 8d fe fe f7 31 fc 00 20 ff f7 92 fe
		fe f7 27 fc 01 20 ff f7 8d fe 00 24 1f e0 35 48
		00 78 00 28 03 d0 58 2d 01 d1 ff f7 55 fe 00 f0
		47 f9 00 bf 2e 48 00 78 00 28 fb d0 00 f0 40 f9
		06 20 01 1b 01 98 08 41 c0 07 c0 0f 00 90 00 98
		ff f7 70 fe 00 20 26 49 08 70 60 1c c4 b2 07 2c
		dd db 00 f0 2d f9 00 24 24 e0 22 48 00 78 00 28
		03 d0 58 2d 01 d1 ff f7 2f fe 00 f0 21 f9 00 bf
		1b 48 00 78 00 28 fb d0 00 f0 1a f9 00 2c 03 d1
		ff f7 40 fe fe f7 ea fb 00 20 15 49 08 70 fe f7
		93 fe 06 46 06 20 01 1b 30 46 88 40 38 43 c7 b2
		60 1c c4 b2 07 2c d8 db 00 f0 02 f9 00 bf 0c 48
		00 78 00 28 fb d0 00 f0 fb f8 ff f7 29 fe fe f7
		cd fb 00 20 ff f7 2e fe 00 20 05 49 08 70 fe f7
		c0 fb fe f7 be fb 00 f0 eb f8 38 46 fe bd 00 00
		3d 00 00 20 3c 00 00 20 00 20 28 49 08 70 28 49
		08 70 28 49 08 70 28 49 08 70 01 20 27 49 08 70
		00 20 48 70 88 70 26 49 08 70 26 49 08 70 26 49
		08 70 26 49 08 70 03 20 25 49 08 70 00 20 25 49
		08 70 25 49 08 70 25 49 08 70 25 49 08 80 40 1e
		24 49 08 80 00 20 24 49 08 70 24 49 08 70 3f 20
		23 49 08 70 23 49 08 70 00 20 23 49 08 70 23 49
		08 70 23 49 08 70 3f 20 22 49 08 70 22 49 08 70
		01 20 22 49 08 70 22 49 08 70 00 20 21 49 08 70
		21 49 08 70 02 20 21 49 08 70 03 20 20 49 08 70
		00 20 20 49 08 70 20 49 08 70 70 47 3c 00 00 20
		3e 00 00 20 3f 00 00 20 48 00 00 20 00 01 00 20
		49 00 00 20 4b 00 00 20 4c 00 00 20 4d 00 00 20
		4e 00 00 20 4f 00 00 20 50 00 00 20 51 00 00 20
		52 00 00 20 54 00 00 20 56 00 00 20 57 00 00 20
		58 00 00 20 59 00 00 20 5a 00 00 20 5d 00 00 20
		80 00 00 20 81 00 00 20 82 00 00 20 83 00 00 20
		84 00 00 20 85 00 00 20 86 00 00 20 87 00 00 20
		88 00 00 20 89 00 00 20 8e 00 00 20 f8 b5 00 bf
		00 bf 00 bf 00 bf 07 20 fe f7 5a fa 40 00 ff 30
		ff 30 02 30 7d 21 c9 00 48 43 07 46 10 49 fd f7
		75 f9 04 46 06 20 fe f7 4b fa 40 00 ff 30 ff 30
		02 30 7d 21 c9 00 48 43 07 46 09 49 fd f7 66 f9
		05 46 64 1b 64 26 c8 20 00 90 b4 42 01 da 00 20
		f8 bd 00 98 84 42 01 dd 02 20 f9 e7 01 20 f7 e7
		ff 03 00 00 78 b5 04 46 0d 46 1e 46 7d 20 c0 00
		70 43 00 90 00 bf 20 68 28 40 90 42 01 d1 01 20
		78 bd 00 98 40 1e 00 90 fe f7 d0 fa 00 98 00 28
		f1 d1 00 bf f4 e7 10 b5 01 20 ff f7 8d fd 10 bd
		00 bf 07 48 07 49 08 60 00 bf 00 bf 01 20 06 49
		c8 60 00 bf 00 bf 00 20 02 49 08 60 00 bf 70 47
		51 e5 cc 1a 00 8c 00 40 00 80 00 40 00 00 00 01
		01 01 01 01 00 00 01 01 01 00 00 00 00 01 00 01
		00 01 01 00 00 01 01 00 00 00 01 00 01 00 01 01
		00 00 01 01 01 00 00 00 00 01 00 01 00 01 01 00
		00 01 01 00 00 00 01 01 01 00 00 01 01 00 01 00
		00 01 00 00 00 01 01 00 00 01 01 00 01 01 00 00
		00 01 00 01 00 00 00 01 00 01 00 00 01 00 00 00
		01 01 01 00 00 01 01 00 01 00 00 01 00 00 00 01
		01 00 00 01 01 00 01 01 00 00 00 01 00 01 00 00
		00 01 00 01 00 00 01 00 00 00 01 01 01 00 00 01
		01 00 01 00 00 01 00 00 00 01 01 00 01 01 01 00
		01 01 00 00 e4 2f 00 00 00 00 00 20 ac 00 00 00
		00 06 00 00 90 30 00 00 ac 00 00 20 74 04 00 00
		10 06 00 00 00 00 00 00 00 00 00 00 00 00 00 00
		00 00 00 00 00 00 00 00 29 07 00 00 e1 06 00 00
		21 06 00 00 61 06 00 00 91 06 00 00 51 07 00 00
		00 00 00 00 00 00 00 00 00 00 00 00 00 00 00 00
		00 00 00 00 00 00 00 00 00 00 00 00 00 00 00 00
		00 00 00 00 00 00 00 00 00 00 00 00 00 00 00 00
		00 00 00 00 00 00 00 00 00 00 00 00 00 00 00 00
		00 00 00 00 00 00 00 00 00 00 00 00 00 00 00 00
		00 00 00 00 00 00 00 00 00 00 00 00 00 00 00 00
		00 00 00 00 00 00 00 00 00 00 00 00 00 00 00 00
		00 00 00 00 00 02 00 08 00 0a 04 fe d3 34 55 34
	];
};
